//****************************************************************************
//
//	Copyright (C) 2012 ZhuoYongHong
//
//	Author	ZhuoYongHong
//
//	File name: app_menuid.c
//	  菜单资源ID
//
//	Revision history
//
//		2012.09.16	ZhuoYongHong Initial version
//
//****************************************************************************
#include <xm_assert.h>
#include "app_menuid.h"
#include "xm_app_menudata.h"
#include "rom.h"

static const APPROMRES MenuID2RomID[AP_LANG_COUNT][AP_ID_COUNT] = {
	// 简体资源
	{
		{ROM_T18_COMMON_BUTTONBACKGROUND_PNG,			ROM_T18_COMMON_BUTTONBACKGROUND_PNG_SIZE},
		{ROM_T18_COMMON_BUTTONSPLITLINE_PNG,            ROM_T18_COMMON_BUTTONSPLITLINE_PNG_SIZE},
		{ROM_T18_COMMON_KEY_PNG,							ROM_T18_COMMON_KEY_PNG_SIZE},
		{ROM_T18_COMMON_LOCK_32_PNG,						ROM_T18_COMMON_LOCK_32_PNG_SIZE},
		{ROM_T18_COMMON_PAUSE_PNG,                                      ROM_T18_COMMON_PAUSE_PNG_SIZE},
		{ROM_T18_COMMON_MENUITEMBACKGROUND_PNG,		ROM_T18_COMMON_MENUITEMBACKGROUND_PNG_SIZE},
		{ROM_T18_COMMON_MENUITEMBACKGROUND6_PNG,		ROM_T18_COMMON_MENUITEMBACKGROUND6_PNG_SIZE},
		{ROM_T18_COMMON_MENUITEMSPLITLINE_PNG,			ROM_T18_COMMON_MENUITEMSPLITLINE_PNG_SIZE},
		{ROM_T18_COMMON_MENUTITLEBARBACKGROUND_PNG,	ROM_T18_COMMON_MENUTITLEBARBACKGROUND_PNG_SIZE},
		{ROM_T18_COMMON_MENU_PNG,							ROM_T18_COMMON_MENU_PNG_SIZE},
		{ROM_T18_COMMON_OK_PNG,								ROM_T18_COMMON_OK_PNG_SIZE},
		{ROM_T18_COMMON_MODE_PNG,							ROM_T18_COMMON_MODE_PNG_SIZE},
		{ROM_T18_COMMON_POWER_PNG,							ROM_T18_COMMON_POWER_PNG_SIZE},
		{ROM_T18_COMMON_SWITCH_PNG,						ROM_T18_COMMON_SWITCH_PNG_SIZE},
		{ROM_T18_COMMON_VIDEOTOOLBARBACKGROUND_PNG,	ROM_T18_COMMON_VIDEOTOOLBARBACKGROUND_PNG_SIZE},
	    {ROM_T18_LANG_CHN_BUTTON_CANCEL_PNG,			ROM_T18_LANG_CHN_BUTTON_CANCEL_PNG_SIZE},
		{ROM_T18_LANG_CHN_BUTTON_MODIFY_PNG,			ROM_T18_LANG_CHN_BUTTON_MODIFY_PNG_SIZE},
		{ROM_T18_LANG_CHN_BUTTON_OK_PNG,					ROM_T18_LANG_CHN_BUTTON_OK_PNG_SIZE},
		{ROM_T18_LANG_CHN_BUTTON_RETURN_PNG,			ROM_T18_LANG_CHN_BUTTON_RETURN_PNG_SIZE},
        {ROM_T18_LANG_CHN_BUTTON_NEXT_PNG,                  ROM_T18_LANG_CHN_BUTTON_NEXT_PNG_SIZE},
		{ROM_T18_LANG_CHN_BUTTON_LAST_PNG,                  ROM_T18_LANG_CHN_BUTTON_LAST_PNG_SIZE},
		{ROM_T18_COMMON_DESKTOP_BIAOCHI_PNG,                  ROM_T18_COMMON_DESKTOP_BIAOCHI_PNG_SIZE},
        
        {ROM_T18_COMMON_MENU_MENU_BG_PNG,      ROM_T18_COMMON_MENU_MENU_BG_PNG_SIZE},
        {ROM_T18_COMMON_MENU_MENU_TOP_PNG,     ROM_T18_COMMON_MENU_MENU_TOP_PNG_SIZE},
        {ROM_T18_COMMON_MENU_MENU_BOTTOM_BAR_PNG,  ROM_T18_COMMON_MENU_MENU_BOTTOM_BAR_PNG_SIZE},
        {ROM_T18_COMMON_MENU_MENU_BOTTOM_BAR_A_PNG,       ROM_T18_COMMON_MENU_MENU_BOTTOM_BAR_A_PNG_SIZE},
        
        {ROM_T18_COMMON_MENU_ICON_DATE_PNG,     ROM_T18_COMMON_MENU_ICON_DATE_PNG_SIZE},
        {ROM_T18_COMMON_MENU_ICON_MOT_PNG,     ROM_T18_COMMON_MENU_ICON_MOT_PNG_SIZE},
        {ROM_T18_COMMON_MENU_ICON_DEC_PNG,     ROM_T18_COMMON_MENU_ICON_DEC_PNG_SIZE},
        {ROM_T18_COMMON_MENU_ICON_COLOR_PNG,     ROM_T18_COMMON_MENU_ICON_COLOR_PNG_SIZE},
        {ROM_T18_COMMON_MENU_ICON_VIDEO_PNG,   ROM_T18_COMMON_MENU_ICON_VIDEO_PNG_SIZE},
        {ROM_T18_COMMON_MENU_ICON_SYS_PNG,     ROM_T18_COMMON_MENU_ICON_SYS_PNG_SIZE},
        
        {ROM_T18_COMMON_MENU_HOME_N_PNG,       ROM_T18_COMMON_MENU_HOME_N_PNG_SIZE},
        {ROM_T18_COMMON_MENU_HOME_A_PNG,       ROM_T18_COMMON_MENU_HOME_A_PNG_SIZE},
        
        {ROM_T18_COMMON_MENU_AVTIVE_BG_PNG,            ROM_T18_COMMON_MENU_AVTIVE_BG_PNG_SIZE},
        {ROM_T18_COMMON_MENU_NORMAL_BG_PNG,            ROM_T18_COMMON_MENU_NORMAL_BG_PNG_SIZE},
        {ROM_T18_COMMON_MENU_SLIDER_THUMB_N_PNG,           ROM_T18_COMMON_MENU_SLIDER_THUMB_N_PNG_SIZE},
        {ROM_T18_COMMON_MENU_COLOR_RULER_PNG,          ROM_T18_COMMON_MENU_COLOR_RULER_PNG_SIZE},

        {ROM_T18_LANG_CHN_SETTING_TXT_TIME_PNG,     ROM_T18_LANG_CHN_SETTING_TXT_TIME_PNG_SIZE},
        {ROM_T18_LANG_CHN_SETTING_TXT_MOT_PNG,      ROM_T18_LANG_CHN_SETTING_TXT_MOT_PNG_SIZE},
        {ROM_T18_LANG_CHN_SETTING_TXT_DEC_PNG,      ROM_T18_LANG_CHN_SETTING_TXT_DEC_PNG_SIZE},
        {ROM_T18_LANG_CHN_SETTING_TXT_COLOR_PNG,    ROM_T18_LANG_CHN_SETTING_TXT_COLOR_PNG_SIZE},
        {ROM_T18_LANG_CHN_SETTING_TXT_REC_PNG,      ROM_T18_LANG_CHN_SETTING_TXT_REC_PNG_SIZE},
        {ROM_T18_LANG_CHN_SETTING_TXT_SYS_PNG,      ROM_T18_LANG_CHN_SETTING_TXT_SYS_PNG_SIZE},

        {ROM_T18_COMMON_MENU_DATE_MENU_ICON_A_PNG,  ROM_T18_COMMON_MENU_DATE_MENU_ICON_A_PNG_SIZE},
        {ROM_T18_COMMON_MENU_DATE_MENU_ICON_N_PNG,  ROM_T18_COMMON_MENU_DATE_MENU_ICON_N_PNG_SIZE},

        {ROM_T18_COMMON_MENU_DATE_MENU_ICON_DATE_PNG,   ROM_T18_COMMON_MENU_DATE_MENU_ICON_DATE_PNG_SIZE},
        {ROM_T18_COMMON_MENU_DATE_MENU_ICON_TIME_PNG,   ROM_T18_COMMON_MENU_DATE_MENU_ICON_TIME_PNG_SIZE},

        {ROM_T18_COMMON_MENU_VIDEO_MENU_ITEM_A_PNG,     ROM_T18_COMMON_MENU_VIDEO_MENU_ITEM_A_PNG_SIZE},
        {ROM_T18_COMMON_MENU_VIDEO_MENU_ITEM_N_PNG,     ROM_T18_COMMON_MENU_VIDEO_MENU_ITEM_N_PNG_SIZE},

        {ROM_T18_COMMON_MENU_VIDEO_MENU_ICON_CYC_PNG,   ROM_T18_COMMON_MENU_VIDEO_MENU_ICON_CYC_PNG_SIZE},
        {ROM_T18_COMMON_MENU_VIDEO_MENU_ICON_WATER_PNG,   ROM_T18_COMMON_MENU_VIDEO_MENU_ICON_WATER_PNG_SIZE},
        {ROM_T18_COMMON_MENU_VIDEO_MENU_ICON_PARKING_LINE_PNG,   ROM_T18_COMMON_MENU_VIDEO_MENU_ICON_PARKING_LINE_PNG_SIZE},
        {ROM_T18_COMMON_MENU_VIDEO_MENU_ICON_PARKING_DELAY_PNG,   ROM_T18_COMMON_MENU_VIDEO_MENU_ICON_PARKING_DELAY_PNG_SIZE},
        {ROM_T18_COMMON_MENU_VIDEO_MENU_CYC_VAL_BG_PNG, ROM_T18_COMMON_MENU_VIDEO_MENU_CYC_VAL_BG_PNG_SIZE},
        
        {ROM_T18_COMMON_MENU_VIDEO_MENU_CLOSE_PNG,      ROM_T18_COMMON_MENU_VIDEO_MENU_CLOSE_PNG_SIZE},
        {ROM_T18_COMMON_MENU_VIDEO_MENU_1TM_PNG,        ROM_T18_COMMON_MENU_VIDEO_MENU_1TM_PNG_SIZE},
        {ROM_T18_COMMON_MENU_VIDEO_MENU_3TM_PNG,        ROM_T18_COMMON_MENU_VIDEO_MENU_3TM_PNG_SIZE},
        {ROM_T18_COMMON_MENU_VIDEO_MENU_5TM_PNG,        ROM_T18_COMMON_MENU_VIDEO_MENU_5TM_PNG_SIZE},
        {ROM_T18_COMMON_MENU_VIDEO_MENU_10TM_PNG,       ROM_T18_COMMON_MENU_VIDEO_MENU_10TM_PNG_SIZE},
        {ROM_T18_COMMON_MENU_VIDEO_MENU_TXT_CYC_PNG,    ROM_T18_COMMON_MENU_VIDEO_MENU_TXT_CYC_PNG_SIZE},
        
        {ROM_T18_COMMON_MENU_VIDEO_MENU_TXT_WATER_PNG,   ROM_T18_COMMON_MENU_VIDEO_MENU_TXT_WATER_PNG_SIZE},
        {ROM_T18_COMMON_MENU_VIDEO_MENU_TXT_PARKING_LINE_PNG,   ROM_T18_COMMON_MENU_VIDEO_MENU_TXT_PARKING_LINE_PNG_SIZE},
        {ROM_T18_COMMON_MENU_VIDEO_MENU_TXT_PARKING_DELAY_PNG,   ROM_T18_COMMON_MENU_VIDEO_MENU_TXT_PARKING_DELAY_PNG_SIZE},

        {ROM_T18_COMMON_MENU_VIDEO_MENU_ICON_MOT_PNG,   ROM_T18_COMMON_MENU_VIDEO_MENU_ICON_MOT_PNG_SIZE},
        {ROM_T18_COMMON_MENU_VIDEO_MENU_TXT_MOT_PNG,   ROM_T18_COMMON_MENU_VIDEO_MENU_TXT_MOT_PNG_SIZE},
        
        {ROM_T18_COMMON_MENU_VIDEO_MENU_SWITCH_ON_PNG,   ROM_T18_COMMON_MENU_VIDEO_MENU_SWITCH_ON_PNG_SIZE},
        {ROM_T18_COMMON_MENU_VIDEO_MENU_SWITCH_OFF_PNG,   ROM_T18_COMMON_MENU_VIDEO_MENU_SWITCH_OFF_PNG_SIZE},
        
        {ROM_T18_COMMON_MENU_SYS_MENU_SYS_ITEM_BG_A_PNG, ROM_T18_COMMON_MENU_SYS_MENU_SYS_ITEM_BG_A_PNG_SIZE},
        {ROM_T18_COMMON_MENU_SYS_MENU_SYS_ITEM_BG_N_PNG, ROM_T18_COMMON_MENU_SYS_MENU_SYS_ITEM_BG_N_PNG_SIZE},

        {ROM_T18_COMMON_MENU_SYS_MENU_TXT_LCD_PRO_PNG, ROM_T18_COMMON_MENU_SYS_MENU_TXT_LCD_PRO_PNG_SIZE},         
        {ROM_T18_COMMON_MENU_SYS_MENU_TXT_FLIP_PNG, ROM_T18_COMMON_MENU_SYS_MENU_TXT_FLIP_PNG_SIZE},     
        {ROM_T18_COMMON_MENU_SYS_MENU_TXT_LANG_PNG, ROM_T18_COMMON_MENU_SYS_MENU_TXT_LANG_PNG_SIZE},
        {ROM_T18_COMMON_MENU_SYS_MENU_TXT_RESET_PNG, ROM_T18_COMMON_MENU_SYS_MENU_TXT_RESET_PNG_SIZE},
        {ROM_T18_COMMON_MENU_SYS_MENU_MIRROR_CH1_PNG, ROM_T18_COMMON_MENU_SYS_MENU_MIRROR_CH1_PNG_SIZE},
        {ROM_T18_COMMON_MENU_SYS_MENU_MIRROR_CH2_PNG, ROM_T18_COMMON_MENU_SYS_MENU_MIRROR_CH2_PNG_SIZE},
        {ROM_T18_COMMON_MENU_SYS_MENU_SD_FORMAT_PNG, ROM_T18_COMMON_MENU_SYS_MENU_SD_FORMAT_PNG_SIZE},
        {ROM_T18_COMMON_MENU_SYS_MENU_TXT_VERSION_PNG, ROM_T18_COMMON_MENU_SYS_MENU_TXT_VERSION_PNG_SIZE},
        
        {ROM_T18_COMMON_MENU_SYS_MENU_FLIP_NOR_PNG, ROM_T18_COMMON_MENU_SYS_MENU_FLIP_NOR_PNG_SIZE},  
        {ROM_T18_COMMON_MENU_SYS_MENU_MIRROR_PNG, ROM_T18_COMMON_MENU_SYS_MENU_MIRROR_PNG_SIZE}, 
        {ROM_T18_COMMON_MENU_SYS_MENU_FLIP_V_PNG,   ROM_T18_COMMON_MENU_SYS_MENU_FLIP_V_PNG_SIZE}, 
        {ROM_T18_COMMON_MENU_SYS_MENU_FLIP_H_PNG,   ROM_T18_COMMON_MENU_SYS_MENU_FLIP_H_PNG_SIZE},  
        
        {ROM_T18_COMMON_MENU_SYS_MENU_LANG_CHT_PNG,     ROM_T18_COMMON_MENU_SYS_MENU_LANG_CHT_PNG_SIZE}, 
        {ROM_T18_COMMON_MENU_SYS_MENU_LANG_CHS_PNG,     ROM_T18_COMMON_MENU_SYS_MENU_LANG_CHS_PNG_SIZE}, 
        {ROM_T18_COMMON_MENU_SYS_MENU_LANG_EN_PNG,      ROM_T18_COMMON_MENU_SYS_MENU_LANG_EN_PNG_SIZE}, 
        
        {ROM_T18_COMMON_MENU_SYS_MENU_SYS_SWITCH_ON_PNG,        ROM_T18_COMMON_MENU_SYS_MENU_SYS_SWITCH_ON_PNG_SIZE},
        {ROM_T18_COMMON_MENU_SYS_MENU_SYS_SWITCH_OFF_PNG,       ROM_T18_COMMON_MENU_SYS_MENU_SYS_SWITCH_OFF_PNG_SIZE},

        {ROM_T18_COMMON_MENU_SYS_MENU_TXT_OK_PNG,           ROM_T18_COMMON_MENU_SYS_MENU_TXT_OK_PNG_SIZE},
        {ROM_T18_COMMON_MENU_SYS_MENU_TXT_CANCEL_PNG,       ROM_T18_COMMON_MENU_SYS_MENU_TXT_CANCEL_PNG_SIZE},
        {ROM_T18_COMMON_MENU_SYS_MENU_ALERT_BTN_A_PNG,      ROM_T18_COMMON_MENU_SYS_MENU_ALERT_BTN_A_PNG_SIZE},

        {ROM_T18_COMMON_MENU_SYS_MENU_TITLE_FORMAT_PNG,     ROM_T18_COMMON_MENU_SYS_MENU_TITLE_FORMAT_PNG_SIZE},
        {ROM_T18_COMMON_MENU_SYS_MENU_TITLE_RESET_PNG,      ROM_T18_COMMON_MENU_SYS_MENU_TITLE_RESET_PNG_SIZE},
        {ROM_T18_COMMON_MENU_SYS_MENU_TITLE_VERSION_PNG,    ROM_T18_COMMON_MENU_SYS_MENU_TITLE_VERSION_PNG_SIZE},
        
		// "设置"资源ID定义
		{ROM_T18_LANG_CHN_SETTING_CLOSE_PNG,			ROM_T18_LANG_CHN_SETTING_CLOSE_PNG_SIZE},
		{ROM_T18_LANG_CHN_SETTING_ICON_PNG,				ROM_T18_LANG_CHN_SETTING_ICON_PNG_SIZE},
		{ROM_T18_LANG_CHN_SETTING_KEY_PNG,				ROM_T18_LANG_CHN_SETTING_KEY_PNG_SIZE},
		{ROM_T18_LANG_CHN_SETTING_LANG_PNG,				ROM_T18_LANG_CHN_SETTING_LANG_PNG_SIZE},
		//{ROM_T18_LANG_CHN_SETTING_LCD_GIF,				ROM_T18_LANG_CHN_SETTING_LCD_GIF_SIZE},
		{ROM_T18_LANG_CHN_SETTING_LANG_PNG,				ROM_T18_LANG_CHN_SETTING_LANG_PNG_SIZE},
		{ROM_T18_LANG_CHN_SETTING_MIC_PNG,				ROM_T18_LANG_CHN_SETTING_MIC_PNG_SIZE},
		{ROM_T18_LANG_CHN_SETTING_OPEN_PNG,				ROM_T18_LANG_CHN_SETTING_OPEN_PNG_SIZE},
		{ROM_T18_LANG_CHN_SETTING_RECORD_PNG,			ROM_T18_LANG_CHN_SETTING_RECORD_PNG_SIZE},
		{ROM_T18_LANG_CHN_SETTING_TIME_PNG,				ROM_T18_LANG_CHN_SETTING_TIME_PNG_SIZE},
		{ROM_T18_LANG_CHN_SETTING_DAYNIGHT_PNG,		ROM_T18_LANG_CHN_SETTING_DAYNIGHT_PNG_SIZE},
		{ROM_T18_LANG_CHN_SETTING_TITLE_PNG,			ROM_T18_LANG_CHN_SETTING_TITLE_PNG_SIZE},

        //color
        {ROM_T18_LANG_CHN_SETTING_COLOR_PICTURE_PNG,  ROM_T18_LANG_CHN_SETTING_COLOR_PICTURE_PNG_SIZE},
        {ROM_T18_LANG_CHN_SETTING_COLOR_COLOR_N_PNG,ROM_T18_LANG_CHN_SETTING_COLOR_COLOR_N_PNG_SIZE},
        {ROM_T18_LANG_CHN_SETTING_COLOR_BRIGHTNESS_N_PNG, ROM_T18_LANG_CHN_SETTING_COLOR_BRIGHTNESS_N_PNG_SIZE},
        {ROM_T18_LANG_CHN_SETTING_COLOR_CONTRAST_N_PNG,   ROM_T18_LANG_CHN_SETTING_COLOR_CONTRAST_N_PNG_SIZE},
		{ROM_T18_LANG_CHN_SETTING_COLOR_SATURATION_N_PNG,   ROM_T18_LANG_CHN_SETTING_COLOR_SATURATION_N_PNG_SIZE},
        {ROM_T18_LANG_CHN_SETTING_COLOR_RESET_PNG,   ROM_T18_LANG_CHN_SETTING_COLOR_RESET_PNG_SIZE},

        {ROM_T18_LANG_CHN_SETTING_COLOR_COLOR_A_PNG,ROM_T18_LANG_CHN_SETTING_COLOR_COLOR_A_PNG_SIZE},
        {ROM_T18_LANG_CHN_SETTING_COLOR_BRIGHTNESS_A_PNG, ROM_T18_LANG_CHN_SETTING_COLOR_BRIGHTNESS_A_PNG_SIZE},
        {ROM_T18_LANG_CHN_SETTING_COLOR_CONTRAST_A_PNG,   ROM_T18_LANG_CHN_SETTING_COLOR_CONTRAST_A_PNG_SIZE},
		{ROM_T18_LANG_CHN_SETTING_COLOR_SATURATION_A_PNG,   ROM_T18_LANG_CHN_SETTING_COLOR_SATURATION_A_PNG_SIZE},
		
        //funciton
        {ROM_T18_LANG_CHN_SETTING_FUNCITON_FUNCTION_PNG,  ROM_T18_LANG_CHN_SETTING_FUNCITON_FUNCTION_PNG_SIZE},
        {ROM_T18_LANG_CHN_SETTING_FUNCITON_ROTATE_PNG,  ROM_T18_LANG_CHN_SETTING_FUNCITON_ROTATE_PNG_SIZE},
        {ROM_T18_LANG_CHN_SETTING_FUNCITON_AUTO_BACKGROUND_PNG,  ROM_T18_LANG_CHN_SETTING_FUNCITON_AUTO_BACKGROUND_PNG_SIZE},
        {ROM_T18_LANG_CHN_SETTING_FUNCITON_BLUE_PNG,  ROM_T18_LANG_CHN_SETTING_FUNCITON_BLUE_PNG_SIZE},
        //Guide delay
        {ROM_T18_LANG_CHN_SETTING_CAMERA_DELAY_PNG,  ROM_T18_LANG_CHN_SETTING_CAMERA_DELAY_PNG_SIZE},
        {ROM_T18_LANG_CHN_SETTING_CAMERA_CAMERA1_PNG,  ROM_T18_LANG_CHN_SETTING_CAMERA_CAMERA1_PNG_SIZE},
        {ROM_T18_LANG_CHN_SETTING_CAMERA_CAMERA2_PNG,  ROM_T18_LANG_CHN_SETTING_CAMERA_CAMERA2_PNG_SIZE},
        {ROM_T18_LANG_CHN_SETTING_CAMERA_CAMERA3_PNG,  ROM_T18_LANG_CHN_SETTING_CAMERA_CAMERA3_PNG_SIZE},
        {ROM_T18_LANG_CHN_SETTING_CAMERA_CAMERA4_PNG,  ROM_T18_LANG_CHN_SETTING_CAMERA_CAMERA4_PNG_SIZE},
        {ROM_T18_LANG_CHN_SETTING_SECOND_PNG,  ROM_T18_LANG_CHN_SETTING_SECOND_PNG_SIZE},
        //GUIDe
        {ROM_T18_LANG_CHN_SETTING_GUIDE_GUIDE_PNG,  ROM_T18_LANG_CHN_SETTING_GUIDE_GUIDE_PNG_SIZE},
        {ROM_T18_LANG_CHN_SETTING_GUIDE_GUIDE1_PNG,  ROM_T18_LANG_CHN_SETTING_GUIDE_GUIDE1_PNG_SIZE},
        {ROM_T18_LANG_CHN_SETTING_GUIDE_GUIDE2_PNG,  ROM_T18_LANG_CHN_SETTING_GUIDE_GUIDE2_PNG_SIZE},
        {ROM_T18_LANG_CHN_SETTING_GUIDE_GUIDE3_PNG,  ROM_T18_LANG_CHN_SETTING_GUIDE_GUIDE3_PNG_SIZE},
        {ROM_T18_LANG_CHN_SETTING_GUIDE_GUIDE4_PNG,  ROM_T18_LANG_CHN_SETTING_GUIDE_GUIDE4_PNG_SIZE},
        //factory
        {ROM_T18_LANG_CHN_SETTING_FACTORY_FACTORY_PNG,  ROM_T18_LANG_CHN_SETTING_FACTORY_FACTORY_PNG_SIZE},
        {ROM_T18_LANG_CHN_SETTING_FACTORY_CARBACK_PNG,  ROM_T18_LANG_CHN_SETTING_FACTORY_CARBACK_PNG_SIZE},
        {ROM_T18_LANG_CHN_SETTING_FACTORY_POWERON_PNG,  ROM_T18_LANG_CHN_SETTING_FACTORY_POWERON_PNG_SIZE},
        {ROM_T18_LANG_CHN_SETTING_FACTORY_AHDCHANNEL_PNG,  ROM_T18_LANG_CHN_SETTING_FACTORY_AHDCHANNEL_PNG_SIZE},
        {ROM_T18_LANG_CHN_SETTING_FACTORY_KEYBOARD_PNG,  ROM_T18_LANG_CHN_SETTING_FACTORY_KEYBOARD_PNG_SIZE},
        {ROM_T18_LANG_CHN_SETTING_FACTORY_VAL_PNG,  ROM_T18_LANG_CHN_SETTING_FACTORY_VAL_PNG_SIZE},
        {ROM_T18_LANG_CHN_SETTING_FACTORY_LOGOENABLE_PNG,  ROM_T18_LANG_CHN_SETTING_FACTORY_LOGOENABLE_PNG_SIZE},
        {ROM_T18_LANG_CHN_SETTING_FACTORY_AUTODIM_PNG,  ROM_T18_LANG_CHN_SETTING_FACTORY_AUTODIM_PNG_SIZE},
        {ROM_T18_LANG_CHN_SETTING_FACTORY_MIDDLELINE_PNG,  ROM_T18_LANG_CHN_SETTING_FACTORY_MIDDLELINE_PNG_SIZE},
        {ROM_T18_LANG_CHN_SETTING_FACTORY_VCOM_PNG,  ROM_T18_LANG_CHN_SETTING_FACTORY_VCOM_PNG_SIZE},
        {ROM_T18_LANG_CHN_SETTING_FACTORY_EXIT_PNG,  ROM_T18_LANG_CHN_SETTING_FACTORY_EXIT_PNG_SIZE},
        {ROM_T18_LANG_CHN_SETTING_FACTORY_TESTKEY_PNG,  ROM_T18_LANG_CHN_SETTING_FACTORY_TESTKEY_PNG_SIZE},
        {ROM_T18_LANG_CHN_SETTING_FACTORY_VERSION_PNG,  ROM_T18_LANG_CHN_SETTING_FACTORY_VERSION_PNG_SIZE},
        {ROM_T18_LANG_CHN_SETTING_FACTORY_730_PNG,  ROM_T18_LANG_CHN_SETTING_FACTORY_730_PNG_SIZE},
        {ROM_T18_LANG_CHN_SETTING_FACTORY_1CH_PNG,  ROM_T18_LANG_CHN_SETTING_FACTORY_1CH_PNG_SIZE},
        {ROM_T18_LANG_CHN_SETTING_FACTORY_2CH_PNG,  ROM_T18_LANG_CHN_SETTING_FACTORY_2CH_PNG_SIZE},
        {ROM_T18_LANG_CHN_SETTING_FACTORY_3CH_PNG,  ROM_T18_LANG_CHN_SETTING_FACTORY_3CH_PNG_SIZE},
        {ROM_T18_LANG_CHN_SETTING_FACTORY_4CH_PNG,  ROM_T18_LANG_CHN_SETTING_FACTORY_4CH_PNG_SIZE},
        {ROM_T18_LANG_CHN_SETTING_FACTORY_POWER_ON_PNG,  ROM_T18_LANG_CHN_SETTING_FACTORY_POWER_ON_PNG_SIZE},
        {ROM_T18_LANG_CHN_SETTING_FACTORY_MEMORY_PNG,  ROM_T18_LANG_CHN_SETTING_FACTORY_MEMORY_PNG_SIZE},
        {ROM_T18_LANG_CHN_SETTING_FACTORY_POWER_OFF_PNG,  ROM_T18_LANG_CHN_SETTING_FACTORY_POWER_OFF_PNG_SIZE},
            
        
		{ROM_T18_SHOW_SHOW_PNG,ROM_T18_SHOW_SHOW_PNG_SIZE},
		{ROM_T18_SHOW_SHOW_1_PNG,ROM_T18_SHOW_SHOW_1_PNG_SIZE},
		{ROM_T18_SHOW_SHOW_2_PNG,ROM_T18_SHOW_SHOW_2_PNG_SIZE},
		{ROM_T18_SHOW_SHOW_3_PNG,ROM_T18_SHOW_SHOW_3_PNG_SIZE},
		{ROM_T18_SHOW_SHOW_DOUBLE_PNG,ROM_T18_SHOW_SHOW_DOUBLE_PNG_SIZE},
		{ROM_T18_SHOW_SHOW_LEFT_PNG,ROM_T18_SHOW_SHOW_LEFT_PNG_SIZE},
		{ROM_T18_SHOW_SHOW_RIGHT_PNG,ROM_T18_SHOW_SHOW_RIGHT_PNG_SIZE},
		{ROM_T18_SHOW_SHOW_UP_PNG,ROM_T18_SHOW_SHOW_UP_PNG_SIZE},
		{ROM_T18_SHOW_SHOW_VERT_PNG,ROM_T18_SHOW_SHOW_VERT_PNG_SIZE},
        //VOL
        {ROM_T18_COMMON_VOL_SELECT_PNG,  ROM_T18_COMMON_VOL_SELECT_PNG_SIZE},
        {ROM_T18_COMMON_VOL_NOSELECT_PNG,  ROM_T18_COMMON_VOL_NOSELECT_PNG_SIZE},
        {ROM_T18_LANG_CHN_SETTING_VOLUME_PNG,ROM_T18_LANG_CHN_SETTING_VOLUME_PNG_SIZE},
        {ROM_T18_LANG_CHN_SETTING_V1V2_3S_PNG,ROM_T18_LANG_CHN_SETTING_V1V2_3S_PNG_SIZE},
        {ROM_T18_LANG_CHN_SETTING_SLEEP_PNG,ROM_T18_LANG_CHN_SETTING_SLEEP_PNG_SIZE},
        //Singed
        {ROM_T18_LANG_CHN_SETTING_SIGNED_BLUE_PNG,      ROM_T18_LANG_CHN_SETTING_SIGNED_BLUE_PNG_SIZE},
        {ROM_T18_LANG_CHN_SETTING_SIGNED_BLACK_PNG,     ROM_T18_LANG_CHN_SETTING_SIGNED_BLACK_PNG_SIZE},
		// "录音"资源ID定义
		{ROM_T18_LANG_CHN_SETTING_MIC_MIC_TITLE_PNG,	ROM_T18_LANG_CHN_SETTING_MIC_MIC_TITLE_PNG_SIZE},
		// 语音提醒TITLE
		{ROM_T18_LANG_CHN_SETTING_VOICE_TITLE_PNG,   ROM_T18_LANG_CHN_SETTING_VOICE_TITLE_PNG_SIZE},
		// "LCD关闭"资源ID定义
		{ROM_T18_LANG_CHN_SETTING_LCD_TITLE_PNG,		ROM_T18_LANG_CHN_SETTING_LCD_TITLE_PNG_SIZE},
		{ROM_T18_LANG_CHN_SETTING_LCD_NEVERCLOSE_PNG,	ROM_T18_LANG_CHN_SETTING_LCD_NEVERCLOSE_PNG_SIZE},
		{ROM_T18_LANG_CHN_SETTING_LCD_S20_PNG,			ROM_T18_LANG_CHN_SETTING_LCD_S20_PNG_SIZE},
		{ROM_T18_LANG_CHN_SETTING_LCD_S30_PNG,			ROM_T18_LANG_CHN_SETTING_LCD_S30_PNG_SIZE},
		{ROM_T18_LANG_CHN_SETTING_LCD_S40_PNG,			ROM_T18_LANG_CHN_SETTING_LCD_S40_PNG_SIZE},
		{ROM_T18_LANG_CHN_SETTING_LCD_S60_PNG,			ROM_T18_LANG_CHN_SETTING_LCD_S60_PNG_SIZE},
		{ROM_T18_LANG_CHN_SETTING_LCD_S120_PNG,		ROM_T18_LANG_CHN_SETTING_LCD_S120_PNG_SIZE},
		{ROM_T18_LANG_CHN_SETTING_LCD_S300_PNG,		ROM_T18_LANG_CHN_SETTING_LCD_S300_PNG_SIZE},
		// "按键音"
		{ROM_T18_LANG_CHN_SETTING_KEY_KEY_TITLE_PNG,	ROM_T18_LANG_CHN_SETTING_KEY_KEY_TITLE_PNG_SIZE},
		// "语言"
		{ROM_T18_LANG_CHN_SETTING_LANG_LANG_TITLE_PNG,	ROM_T18_LANG_CHN_SETTING_LANG_LANG_TITLE_PNG_SIZE	},
		// "时间设置"
		{ROM_T18_LANG_CHN_SETTING_TIME_TIME_TITLE_PNG,	ROM_T18_LANG_CHN_SETTING_TIME_TIME_TITLE_PNG_SIZE	},
		{ROM_T18_LANG_CHN_SETTING_TIME_BTN_NEXT_PNG,	ROM_T18_LANG_CHN_SETTING_TIME_BTN_NEXT_PNG_SIZE	},	

		// 卡信息标题
		{ROM_T18_LANG_CHN_VIDEOITEM_INFO_LOW_SPACE_PNG, ROM_T18_LANG_CHN_VIDEOITEM_INFO_LOW_SPACE_PNG_SIZE},
		{ROM_T18_LANG_CHN_VIDEOITEM_INFO_LOW_SPEED_PNG, ROM_T18_LANG_CHN_VIDEOITEM_INFO_LOW_SPEED_PNG_SIZE},
		{ROM_T18_LANG_CHN_VIDEOITEM_INFO_LOW_PREFORMANCE_PNG, ROM_T18_LANG_CHN_VIDEOITEM_INFO_LOW_PREFORMANCE_PNG_SIZE},
		{ROM_T18_LANG_CHN_VIDEOITEM_INFO_RECYCLE_CONSUMED_PNG, ROM_T18_LANG_CHN_VIDEOITEM_INFO_RECYCLE_CONSUMED_PNG_SIZE},

		// 卡格式化提示信息
		{ROM_T18_LANG_CHN_CARD_INFO_FORMAT_INITIAL_PNG, ROM_T18_LANG_CHN_CARD_INFO_FORMAT_INITIAL_PNG_SIZE},
		{ROM_T18_LANG_CHN_CARD_INFO_FORMATCONFIRM_PNG, ROM_T18_LANG_CHN_CARD_INFO_FORMATCONFIRM_PNG_SIZE},
		{ROM_T18_LANG_CHN_CARD_INFO_FORMATTING_PNG, ROM_T18_LANG_CHN_CARD_INFO_FORMATTING_PNG_SIZE},
		{ROM_T18_LANG_CHN_CARD_INFO_FORMATSUCCESS_PNG, ROM_T18_LANG_CHN_CARD_INFO_FORMATSUCCESS_PNG_SIZE},
		{ROM_T18_LANG_CHN_CARD_INFO_FORMATFAILURE_PNG, ROM_T18_LANG_CHN_CARD_INFO_FORMATFAILURE_PNG_SIZE},

		// 系统升级提示信息
		{ROM_T18_LANG_CHN_CARD_INFO_SYSUPDATE_INITIAL_PNG, ROM_T18_LANG_CHN_CARD_INFO_SYSUPDATE_INITIAL_PNG_SIZE},
		{ROM_T18_LANG_CHN_CARD_INFO_SYSUPDATE_CONFIRM_PNG, ROM_T18_LANG_CHN_CARD_INFO_SYSUPDATE_CONFIRM_PNG_SIZE},
		{ROM_T18_LANG_CHN_CARD_INFO_SYSUPDATE_WORKING_PNG, ROM_T18_LANG_CHN_CARD_INFO_SYSUPDATE_WORKING_PNG_SIZE},
		{ROM_T18_LANG_CHN_CARD_INFO_SYSUPDATE_SUCCESS_PNG, ROM_T18_LANG_CHN_CARD_INFO_SYSUPDATE_SUCCESS_PNG_SIZE},
		{ROM_T18_LANG_CHN_CARD_INFO_SYSUPDATE_FAILURE_PNG, ROM_T18_LANG_CHN_CARD_INFO_SYSUPDATE_FAILURE_PNG_SIZE},
		{ROM_T18_LANG_CHN_SYSTEMSETTING_SYSTEM_REBOOT_PNG, ROM_T18_LANG_CHN_SYSTEMSETTING_SYSTEM_REBOOT_PNG_SIZE},
		{ROM_T18_LANG_CHN_SYSTEMSETTING_UPDATE_UPDATE_FINISH_PNG, ROM_T18_LANG_CHN_SYSTEMSETTING_UPDATE_UPDATE_FINISH_PNG_SIZE},

		// 恢复出厂设置提示信息
		{ROM_T18_LANG_CHN_CARD_INFO_RESTORE_INITIAL_PNG, ROM_T18_LANG_CHN_CARD_INFO_RESTORE_INITIAL_PNG_SIZE},
		{ROM_T18_LANG_CHN_CARD_INFO_RESTORE_CONFIRM_PNG, ROM_T18_LANG_CHN_CARD_INFO_RESTORE_CONFIRM_PNG_SIZE},
		{ROM_T18_LANG_CHN_CARD_INFO_RESTORE_WORKING_PNG, ROM_T18_LANG_CHN_CARD_INFO_RESTORE_WORKING_PNG_SIZE},
		{ROM_T18_LANG_CHN_CARD_INFO_RESTORE_SUCCESS_PNG, ROM_T18_LANG_CHN_CARD_INFO_RESTORE_SUCCESS_PNG_SIZE},
		{ROM_T18_LANG_CHN_CARD_INFO_RESTORE_FAILURE_PNG, ROM_T18_LANG_CHN_CARD_INFO_RESTORE_FAILURE_PNG_SIZE},

		// SD卡 弹窗标题		
		{ROM_T18_LANG_CHN_CARD_SDCARD_PNG, ROM_T18_LANG_CHN_CARD_SDCARD_PNG_SIZE},		// SDCARD ICON
		{ROM_T18_LANG_CHN_CARD_MESSAGE_TITLE_CARD_DETECT_PNG, ROM_T18_LANG_CHN_CARD_MESSAGE_TITLE_CARD_DETECT_PNG_SIZE},
		{ROM_T18_LANG_CHN_CARD_MESSAGE_TITLE_CARD_INSERT_PNG, ROM_T18_LANG_CHN_CARD_MESSAGE_TITLE_CARD_INSERT_PNG_SIZE},
		{ROM_T18_LANG_CHN_CARD_MESSAGE_TITLE_CARD_WITHDRAW_PNG, ROM_T18_LANG_CHN_CARD_MESSAGE_TITLE_CARD_WITHDRAW_PNG_SIZE},
		{ROM_T18_LANG_CHN_CARD_MESSAGE_TITLE_CARD_FSERROR_PNG, ROM_T18_LANG_CHN_CARD_MESSAGE_TITLE_CARD_FSERROR_PNG_SIZE},
		{ROM_T18_LANG_CHN_CARD_MESSAGE_TITLE_CARD_VERIFYFAILED_PNG, ROM_T18_LANG_CHN_CARD_MESSAGE_TITLE_CARD_VERIFYFAILED_PNG_SIZE},
		{ROM_T18_LANG_CHN_CARD_MESSAGE_TITLE_CARD_INVALID_PNG, ROM_T18_LANG_CHN_CARD_MESSAGE_TITLE_CARD_INVALID_PNG_SIZE},
		// “SD卡已写满，需要重新格式化”
		{ROM_T18_LANG_CHN_CARD_MESSAGE_TITLE_CARD_DISK_FULL_PNG,ROM_T18_LANG_CHN_CARD_MESSAGE_TITLE_CARD_DISK_FULL_PNG_SIZE},

		// Camera 摄像头
		{ROM_T18_LANG_CHN_CAMERA_INFO_CAMERADISCONNECT_PNG, ROM_T18_LANG_CHN_CAMERA_INFO_CAMERADISCONNECT_PNG_SIZE},
		{ROM_T18_LANG_CHN_CAMERA_ICON_CAMERADISCONNECT_PNG, ROM_T18_LANG_CHN_CAMERA_ICON_CAMERADISCONNECT_PNG_SIZE},

		// 电池信息
		{ROM_T18_LANG_CHN_BATTERY_INFO_MAINBATTERY_WORST_PNG, ROM_T18_LANG_CHN_BATTERY_INFO_MAINBATTERY_WORST_PNG_SIZE},
		{ROM_T18_LANG_CHN_BATTERY_INFO_BACKUPBATTERY_WORST_PNG, ROM_T18_LANG_CHN_BATTERY_INFO_BACKUPBATTERY_WORST_PNG_SIZE},
		{ROM_T18_LANG_CHN_BATTERY_BATTERY_ICON_PNG, ROM_T18_LANG_CHN_BATTERY_BATTERY_ICON_PNG_SIZE},

		// “录像设置”
		{ROM_T18_LANG_CHN_VIDEOSETTING_TITLE_PNG, ROM_T18_LANG_CHN_VIDEOSETTING_TITLE_PNG_SIZE},
		{ROM_T18_LANG_CHN_VIDEOSETTING_BUTTON_WATERMARK_PNG, ROM_T18_LANG_CHN_VIDEOSETTING_BUTTON_WATERMARK_PNG_SIZE},
		{ROM_T18_LANG_CHN_VIDEOSETTING_BUTTON_SYSTEM_PNG, ROM_T18_LANG_CHN_VIDEOSETTING_BUTTON_SYSTEM_PNG_SIZE},
		{ROM_T18_LANG_CHN_VIDEOSETTING_VOICEPROMPTS_PNG, ROM_T18_LANG_CHN_VIDEOSETTING_VOICEPROMPTS_PNG_SIZE},
		//{ROM_T18_LANG_CHN_VIDEOSETTING_RECORDTIMEALARM_PNG, ROM_T18_LANG_CHN_VIDEOSETTING_RECORDTIMEALARM_PNG_SIZE},
		{ROM_T18_LANG_CHN_VIDEOSETTING_VIDEOSEGMENTSIZE_PNG, ROM_T18_LANG_CHN_VIDEOSETTING_VIDEOSEGMENTSIZE_PNG_SIZE},
		{ROM_T18_LANG_CHN_VIDEOSETTING_COLLISIONSENSITIVITY_PNG, ROM_T18_LANG_CHN_VIDEOSETTING_COLLISIONSENSITIVITY_PNG_SIZE},
		{ROM_T18_LANG_CHN_VIDEOSETTING_TIMEWATERMARK_PNG, ROM_T18_LANG_CHN_VIDEOSETTING_TIMEWATERMARK_PNG_SIZE},
		{ROM_T18_LANG_CHN_VIDEOSETTING_RECORDDELAY_PNG, ROM_T18_LANG_CHN_VIDEOSETTING_RECORDDELAY_PNG_SIZE},
		{ROM_T18_LANG_CHN_VIDEOSETTING_URGENTRECORDTIME_PNG, ROM_T18_LANG_CHN_VIDEOSETTING_URGENTRECORDTIME_PNG_SIZE},
		{ROM_T18_LANG_CHN_VIDEOSETTING_RECORD_RESOLUTION_PNG, ROM_T18_LANG_CHN_VIDEOSETTING_RECORD_RESOLUTION_PNG_SIZE},
		{ROM_T18_LANG_CHN_VIDEOSETTING_EXPOSURECOMPENSATION_PNG,ROM_T18_LANG_CHN_VIDEOSETTING_EXPOSURECOMPENSATION_PNG_SIZE},
		{ROM_T18_LANG_CHN_VIDEOSETTING_LIGHTFREQ_PNG,ROM_T18_LANG_CHN_VIDEOSETTING_LIGHTFREQ_PNG_SIZE},
		
		{ROM_T18_LANG_CHN_VIDEOSETTING_VOICEPROMPTS_TITLE_GIF, ROM_T18_LANG_CHN_VIDEOSETTING_VOICEPROMPTS_TITLE_GIF_SIZE},
		{ROM_T18_LANG_CHN_VIDEOSETTING_RECORDTIMEALARM_TITLE_PNG, ROM_T18_LANG_CHN_VIDEOSETTING_RECORDTIMEALARM_TITLE_PNG_SIZE},
		{ROM_T18_LANG_CHN_VIDEOSETTING_RECORDTIMEALARM_MIN5_PNG, ROM_T18_LANG_CHN_VIDEOSETTING_RECORDTIMEALARM_MIN5_PNG_SIZE},
		{ROM_T18_LANG_CHN_VIDEOSETTING_RECORDTIMEALARM_MIN10_PNG, ROM_T18_LANG_CHN_VIDEOSETTING_RECORDTIMEALARM_MIN10_PNG_SIZE},
		{ROM_T18_LANG_CHN_VIDEOSETTING_RECORDTIMEALARM_MIN15_PNG, ROM_T18_LANG_CHN_VIDEOSETTING_RECORDTIMEALARM_MIN15_PNG_SIZE},
		{ROM_T18_LANG_CHN_VIDEOSETTING_RECORDTIMEALARM_MIN20_PNG, ROM_T18_LANG_CHN_VIDEOSETTING_RECORDTIMEALARM_MIN20_PNG_SIZE},
		{ROM_T18_LANG_CHN_VIDEOSETTING_RECORDTIMEALARM_MIN30_PNG, ROM_T18_LANG_CHN_VIDEOSETTING_RECORDTIMEALARM_MIN30_PNG_SIZE},
		{ROM_T18_LANG_CHN_VIDEOSETTING_RECORDTIMEALARM_HOUR1_PNG, ROM_T18_LANG_CHN_VIDEOSETTING_RECORDTIMEALARM_HOUR1_PNG_SIZE},
		{ROM_T18_LANG_CHN_VIDEOSETTING_RECORDTIMEALARM_HOUR2_PNG, ROM_T18_LANG_CHN_VIDEOSETTING_RECORDTIMEALARM_HOUR2_PNG_SIZE},
		
		{ROM_T18_LANG_CHN_VIDEOSETTING_VIDEOSEGMENTSIZE_TITLE_PNG, ROM_T18_LANG_CHN_VIDEOSETTING_VIDEOSEGMENTSIZE_TITLE_PNG_SIZE},
		{ROM_T18_LANG_CHN_VIDEOSETTING_VIDEOSEGMENTSIZE_2_MINUTE_PNG, ROM_T18_LANG_CHN_VIDEOSETTING_VIDEOSEGMENTSIZE_2_MINUTE_PNG_SIZE},
		{ROM_T18_LANG_CHN_VIDEOSETTING_VIDEOSEGMENTSIZE_3_MINUTE_PNG, ROM_T18_LANG_CHN_VIDEOSETTING_VIDEOSEGMENTSIZE_3_MINUTE_PNG_SIZE},
		{ROM_T18_LANG_CHN_VIDEOSETTING_VIDEOSEGMENTSIZE_5_MINUTE_PNG, ROM_T18_LANG_CHN_VIDEOSETTING_VIDEOSEGMENTSIZE_5_MINUTE_PNG_SIZE},

		// 碰撞灵敏度
		{ROM_T18_LANG_CHN_VIDEOSETTING_COLLISIONSENSITIVITY_TITLE_PNG, ROM_T18_LANG_CHN_VIDEOSETTING_COLLISIONSENSITIVITY_TITLE_PNG_SIZE},
		{ROM_T18_LANG_CHN_VIDEOSETTING_COLLISIONSENSITIVITY_LOW_PNG, ROM_T18_LANG_CHN_VIDEOSETTING_COLLISIONSENSITIVITY_LOW_PNG_SIZE},
		{ROM_T18_LANG_CHN_VIDEOSETTING_COLLISIONSENSITIVITY_MEDIUM_PNG, ROM_T18_LANG_CHN_VIDEOSETTING_COLLISIONSENSITIVITY_MEDIUM_PNG_SIZE},
		{ROM_T18_LANG_CHN_VIDEOSETTING_COLLISIONSENSITIVITY_HIGH_PNG, ROM_T18_LANG_CHN_VIDEOSETTING_COLLISIONSENSITIVITY_HIGH_PNG_SIZE},

		{ROM_T18_LANG_CHN_VIDEOSETTING_TIMEWATERMARK_TITLE_PNG, ROM_T18_LANG_CHN_VIDEOSETTING_TIMEWATERMARK_TITLE_PNG_SIZE},

		// “记录延时”
		{ROM_T18_LANG_CHN_VIDEOSETTING_RECORDDELAY_TITLE_PNG, ROM_T18_LANG_CHN_VIDEOSETTING_RECORDDELAY_TITLE_PNG_SIZE},
		{ROM_T18_LANG_CHN_VIDEOSETTING_RECORDDELAY_S0_PNG, ROM_T18_LANG_CHN_VIDEOSETTING_RECORDDELAY_S0_PNG_SIZE},
		{ROM_T18_LANG_CHN_VIDEOSETTING_RECORDDELAY_S3_PNG, ROM_T18_LANG_CHN_VIDEOSETTING_RECORDDELAY_S3_PNG_SIZE},
		{ROM_T18_LANG_CHN_VIDEOSETTING_RECORDDELAY_S5_PNG, ROM_T18_LANG_CHN_VIDEOSETTING_RECORDDELAY_S5_PNG_SIZE},
		{ROM_T18_LANG_CHN_VIDEOSETTING_RECORDDELAY_S10_PNG, ROM_T18_LANG_CHN_VIDEOSETTING_RECORDDELAY_S10_PNG_SIZE},
		{ROM_T18_LANG_CHN_VIDEOSETTING_RECORDDELAY_S15_PNG, ROM_T18_LANG_CHN_VIDEOSETTING_RECORDDELAY_S15_PNG_SIZE},
		{ROM_T18_LANG_CHN_VIDEOSETTING_RECORDDELAY_S20_PNG, ROM_T18_LANG_CHN_VIDEOSETTING_RECORDDELAY_S20_PNG_SIZE},
		{ROM_T18_LANG_CHN_VIDEOSETTING_RECORDDELAY_S30_PNG, ROM_T18_LANG_CHN_VIDEOSETTING_RECORDDELAY_S30_PNG_SIZE},

		{ROM_T18_LANG_CHN_VIDEOSETTING_URGENTRECORD_TITLE_PNG, ROM_T18_LANG_CHN_VIDEOSETTING_URGENTRECORD_TITLE_PNG_SIZE},

		//录像分辨率设置
		{ROM_T18_LANG_CHN_VIDEOSETTING_RECORDRESOLUTION_TITLE_PNG, ROM_T18_LANG_CHN_VIDEOSETTING_RECORDRESOLUTION_TITLE_PNG_SIZE},
		{ROM_T18_LANG_CHN_VIDEOSETTING_RECORDRESOLUTION_1080P_30_PNG, ROM_T18_LANG_CHN_VIDEOSETTING_RECORDRESOLUTION_1080P_30_PNG_SIZE},
		{ROM_T18_LANG_CHN_VIDEOSETTING_RECORDRESOLUTION_1080P_60_PNG, ROM_T18_LANG_CHN_VIDEOSETTING_RECORDRESOLUTION_1080P_60_PNG_SIZE},
		{ROM_T18_LANG_CHN_VIDEOSETTING_RECORDRESOLUTION_720P_30_PNG, ROM_T18_LANG_CHN_VIDEOSETTING_RECORDRESOLUTION_720P_30_PNG_SIZE},
		{ROM_T18_LANG_CHN_VIDEOSETTING_RECORDRESOLUTION_720P_60_PNG, ROM_T18_LANG_CHN_VIDEOSETTING_RECORDRESOLUTION_720P_60_PNG_SIZE},

		//录像曝光补偿设置
		{ROM_T18_LANG_CHN_VIDEOSETTING_EXPOSURECOMPENSATION_TITLE_PNG, ROM_T18_LANG_CHN_VIDEOSETTING_EXPOSURECOMPENSATION_TITLE_PNG_SIZE},
		{ROM_T18_LANG_CHN_VIDEOSETTING_EXPOSURECOMPENSATION_NEGA_2_PNG, ROM_T18_LANG_CHN_VIDEOSETTING_EXPOSURECOMPENSATION_NEGA_2_PNG_SIZE},
		{ROM_T18_LANG_CHN_VIDEOSETTING_EXPOSURECOMPENSATION_NEGA_1_PNG, ROM_T18_LANG_CHN_VIDEOSETTING_EXPOSURECOMPENSATION_NEGA_1_PNG_SIZE},
        {ROM_T18_LANG_CHN_VIDEOSETTING_EXPOSURECOMPENSATION_POSI_0_PNG, ROM_T18_LANG_CHN_VIDEOSETTING_EXPOSURECOMPENSATION_POSI_0_PNG_SIZE},
		{ROM_T18_LANG_CHN_VIDEOSETTING_EXPOSURECOMPENSATION_POSI_1_PNG, ROM_T18_LANG_CHN_VIDEOSETTING_EXPOSURECOMPENSATION_POSI_1_PNG_SIZE},
		{ROM_T18_LANG_CHN_VIDEOSETTING_EXPOSURECOMPENSATION_POSI_2_PNG, ROM_T18_LANG_CHN_VIDEOSETTING_EXPOSURECOMPENSATION_POSI_2_PNG_SIZE},

         //录像光源频率
		{ROM_T18_LANG_CHN_VIDEOSETTING_LIGHTFREQ_TITLE_PNG, ROM_T18_LANG_CHN_VIDEOSETTING_LIGHTFREQ_TITLE_PNG_SIZE},
		{ROM_T18_LANG_CHN_VIDEOSETTING_LIGHTFREQ_50HZ_PNG, ROM_T18_LANG_CHN_VIDEOSETTING_LIGHTFREQ_50HZ_PNG_SIZE},
		{ROM_T18_LANG_CHN_VIDEOSETTING_LIGHTFREQ_60HZ_PNG, ROM_T18_LANG_CHN_VIDEOSETTING_LIGHTFREQ_60HZ_PNG_SIZE},
		{ROM_T18_LANG_CHN_VIDEOSETTING_LIGHTFREQ_CLOSE_PNG, ROM_T18_LANG_CHN_VIDEOSETTING_LIGHTFREQ_CLOSE_PNG_SIZE},

         //停车监控标题
		{ROM_T18_LANG_CHN_VIDEOSETTING_PARKMONITOR_TITILE_PNG, ROM_T18_LANG_CHN_VIDEOSETTING_PARKMONITOR_TITILE_PNG_SIZE},

		// “水印设置”
		{ROM_T18_LANG_CHN_WATERMARKSETTING_TITLE_PNG, ROM_T18_LANG_CHN_WATERMARKSETTING_TITLE_PNG_SIZE},
		{ROM_T18_LANG_CHN_WATERMARKSETTING_TIME_WATERMARK_PNG, ROM_T18_LANG_CHN_WATERMARKSETTING_TIME_WATERMARK_PNG_SIZE},
		{ROM_T18_LANG_CHN_WATERMARKSETTING_GPS_WATERMARK_PNG, ROM_T18_LANG_CHN_WATERMARKSETTING_GPS_WATERMARK_PNG_SIZE},
		{ROM_T18_LANG_CHN_WATERMARKSETTING_LOGO_WATERMARK_PNG, ROM_T18_LANG_CHN_WATERMARKSETTING_LOGO_WATERMARK_PNG_SIZE},
		{ROM_T18_LANG_CHN_WATERMARKSETTING_LOGO_WATERMARK_LOAD_PNG, ROM_T18_LANG_CHN_WATERMARKSETTING_LOGO_WATERMARK_LOAD_PNG_SIZE},
		{ROM_T18_LANG_CHN_WATERMARKSETTING_LOGOPNGLOAD_TITLE_PNG, ROM_T18_LANG_CHN_WATERMARKSETTING_LOGOPNGLOAD_TITLE_PNG_SIZE},

		// "语音助手提醒"
		{ROM_T18_LANG_CHN_SETTING_VOICE_TITLE_PNG, ROM_T18_LANG_CHN_SETTING_VOICE_TITLE_PNG_SIZE},
		{ROM_T18_LANG_CHN_SETTING_VOICE_BATTERY_ALARM_PNG, ROM_T18_LANG_CHN_SETTING_VOICE_BATTERY_ALARM_PNG_SIZE},
		{ROM_T18_LANG_CHN_SETTING_VOICE_CARD_STATUS_ALARM_PNG, ROM_T18_LANG_CHN_SETTING_VOICE_CARD_STATUS_ALARM_PNG_SIZE},
		{ROM_T18_LANG_CHN_SETTING_VOICE_DRIVE_ALARM_PNG, ROM_T18_LANG_CHN_SETTING_VOICE_DRIVE_ALARM_PNG_SIZE},
		{ROM_T18_LANG_CHN_SETTING_VOICE_MIC_STATE_ALARM_PNG, ROM_T18_LANG_CHN_SETTING_VOICE_MIC_STATE_ALARM_PNG_SIZE},
		{ROM_T18_LANG_CHN_SETTING_VOICE_NAVIGATE_STATUS_ALARM_PNG, ROM_T18_LANG_CHN_SETTING_VOICE_NAVIGATE_STATUS_ALARM_PNG_SIZE},
		{ROM_T18_LANG_CHN_SETTING_VOICE_REC_STATE_ALARM_PNG, ROM_T18_LANG_CHN_SETTING_VOICE_REC_STATE_ALARM_PNG_SIZE},
		{ROM_T18_LANG_CHN_SETTING_VOICE_STORAGE_ALARM_PNG, ROM_T18_LANG_CHN_SETTING_VOICE_STORAGE_ALARM_PNG_SIZE},
		{ROM_T18_LANG_CHN_SETTING_VOICE_URGENT_RECORD_ALARM_PNG, ROM_T18_LANG_CHN_SETTING_VOICE_URGENT_RECORD_ALARM_PNG_SIZE},

		// “系统设置”
		{ROM_T18_LANG_CHN_SYSTEMSETTING_TITLE_PNG, ROM_T18_LANG_CHN_SYSTEMSETTING_TITLE_PNG_SIZE },
		{ROM_T18_LANG_CHN_SYSTEMSETTING_BUTTON_SETTING_PNG, ROM_T18_LANG_CHN_SYSTEMSETTING_BUTTON_SETTING_PNG_SIZE},
		{ROM_T18_LANG_CHN_SYSTEMSETTING_DEMOMODE_GIF, ROM_T18_LANG_CHN_SYSTEMSETTING_DEMOMODE_GIF_SIZE},
		{ROM_T18_LANG_CHN_SYSTEMSETTING_FORMAT_PNG, ROM_T18_LANG_CHN_SYSTEMSETTING_FORMAT_PNG_SIZE},
		{ROM_T18_LANG_CHN_SYSTEMSETTING_RESTORESETTING_PNG, ROM_T18_LANG_CHN_SYSTEMSETTING_RESTORESETTING_PNG_SIZE},
		{ROM_T18_LANG_CHN_SYSTEMSETTING_RESTORESETTING_TITLE_PNG, ROM_T18_LANG_CHN_SYSTEMSETTING_RESTORESETTING_TITLE_PNG_SIZE},
		{ROM_T18_LANG_CHN_SYSTEMSETTING_RESTORESETTING_INFO_GIF, ROM_T18_LANG_CHN_SYSTEMSETTING_RESTORESETTING_INFO_GIF_SIZE},
		{ROM_T18_LANG_CHN_SYSTEMSETTING_SYSTEMUPDATE_PNG, ROM_T18_LANG_CHN_SYSTEMSETTING_SYSTEMUPDATE_PNG_SIZE},
		{ROM_T18_LANG_CHN_SYSTEMSETTING_SOFTWAREVERSION_PNG, ROM_T18_LANG_CHN_SYSTEMSETTING_SOFTWAREVERSION_PNG_SIZE},
		{ROM_T18_LANG_CHN_SYSTEMSETTING_SDCARDVOLUME_PNG, ROM_T18_LANG_CHN_SYSTEMSETTING_SDCARDVOLUME_PNG_SIZE},
		{ROM_T18_LANG_CHN_SYSTEMSETTING_SDCARD_TITLE_PNG, ROM_T18_LANG_CHN_SYSTEMSETTING_SDCARD_TITLE_PNG_SIZE},
		{ROM_T18_LANG_CHN_SYSTEMSETTING_SOFTWAREVERSION_TITLE_PNG, ROM_T18_LANG_CHN_SYSTEMSETTING_SOFTWAREVERSION_TITLE_PNG_SIZE},

		{ROM_T18_LANG_CHN_SYSTEMSETTING_FORMAT_TITLE_PNG, ROM_T18_LANG_CHN_SYSTEMSETTING_FORMAT_TITLE_PNG_SIZE},
		{ROM_T18_LANG_CHN_SYSTEMSETTING_UPDATE_TITLE_PNG, ROM_T18_LANG_CHN_SYSTEMSETTING_UPDATE_TITLE_PNG_SIZE},
		{ROM_T18_LANG_CHN_SYSTEMSETTING_UPDATE_CURRENTVER_GIF, ROM_T18_LANG_CHN_SYSTEMSETTING_UPDATE_CURRENTVER_GIF_SIZE},
		{ROM_T18_LANG_CHN_SYSTEMSETTING_UPDATE_UPDATEVER_GIF, ROM_T18_LANG_CHN_SYSTEMSETTING_UPDATE_UPDATEVER_GIF_SIZE},
		{ROM_T18_LANG_CHN_SYSTEMSETTING_UPDATE_FILEABNORMAL_GIF, ROM_T18_LANG_CHN_SYSTEMSETTING_UPDATE_FILEABNORMAL_GIF_SIZE},

		// “录像”
		{ROM_T18_LANG_CHN_VIDEO_TITLE_CIRCULARVIDEO_PNG, ROM_T18_LANG_CHN_VIDEO_TITLE_CIRCULARVIDEO_PNG_SIZE},
		{ROM_T18_LANG_CHN_VIDEO_TITLE_PROTECTEDVIDEO_PNG, ROM_T18_LANG_CHN_VIDEO_TITLE_PROTECTEDVIDEO_PNG_SIZE},
		{ROM_T18_LANG_CHN_VIDEO_TITLE_COMMAND_PNG, ROM_T18_LANG_CHN_VIDEO_TITLE_COMMAND_PNG_SIZE },
		{ROM_T18_LANG_CHN_VIDEO_CIRCULARVIDEO_PNG, ROM_T18_LANG_CHN_VIDEO_CIRCULARVIDEO_PNG_SIZE},
		{ROM_T18_LANG_CHN_VIDEO_COMMAND_PNG,	ROM_T18_LANG_CHN_VIDEO_COMMAND_PNG_SIZE	},	
		{ROM_T18_LANG_CHN_VIDEO_LOCKVIDEO_PNG, ROM_T18_LANG_CHN_VIDEO_LOCKVIDEO_PNG_SIZE},
		{ROM_T18_LANG_CHN_VIDEO_PLAY_PNG,		ROM_T18_LANG_CHN_VIDEO_PLAY_PNG_SIZE },
		{ROM_T18_LANG_CHN_VIDEO_PROTECTEDVIDEO_PNG, ROM_T18_LANG_CHN_VIDEO_PROTECTEDVIDEO_PNG_SIZE},
		{ROM_T18_LANG_CHN_VIDEO_UNLOCKVIDEO_PNG,	ROM_T18_LANG_CHN_VIDEO_UNLOCKVIDEO_PNG_SIZE},
		{ROM_T18_LANG_CHN_VIDEO_BUTTON_VIDEO_PNG, ROM_T18_LANG_CHN_VIDEO_BUTTON_VIDEO_PNG_SIZE},
		{ROM_T18_LANG_CHN_VIDEO_TITLE_VIDEO_PNG, ROM_T18_LANG_CHN_VIDEO_TITLE_VIDEO_PNG_SIZE},
		{ROM_T18_LANG_CHN_VIDEO_BUTTON_ALBUM_PNG, ROM_T18_LANG_CHN_VIDEO_BUTTON_ALBUM_PNG_SIZE},
		{ROM_T18_LANG_CHN_VIDEO_TITLE_ALBUM_PNG, ROM_T18_LANG_CHN_VIDEO_TITLE_ALBUM_PNG_SIZE},
		{ROM_T18_LANG_CHN_VIDEO_BUTTON_VIEW_PNG, ROM_T18_LANG_CHN_VIDEO_BUTTON_VIEW_PNG_SIZE},
		{ROM_T18_LANG_CHN_VIDEO_BUTTON_DELETE_ONE_PNG, ROM_T18_LANG_CHN_VIDEO_BUTTON_DELETE_ONE_PNG_SIZE},
		{ROM_T18_LANG_CHN_VIDEO_BUTTON_DELETE_ALL_PNG, ROM_T18_LANG_CHN_VIDEO_BUTTON_DELETE_ALL_PNG_SIZE},
		{ROM_T18_LANG_CHN_VIDEO_INFO_TO_DELETE_PHOTO_PNG, ROM_T18_LANG_CHN_VIDEO_INFO_TO_DELETE_PHOTO_PNG_SIZE},
		{ROM_T18_LANG_CHN_VIDEO_INFO_TO_DELETE_ALL_PHOTO_PNG, ROM_T18_LANG_CHN_VIDEO_INFO_TO_DELETE_ALL_PHOTO_PNG_SIZE},
		{ROM_T18_LANG_CHN_VIDEO_BUTTON_DELETE_YES_PNG, ROM_T18_LANG_CHN_VIDEO_BUTTON_DELETE_YES_PNG_SIZE},
		{ROM_T18_LANG_CHN_VIDEO_BUTTON_CANCEL_NO_PNG, ROM_T18_LANG_CHN_VIDEO_BUTTON_CANCEL_NO_PNG_SIZE},
		{ROM_T18_LANG_CHN_VIDEO_BUTTON_LOCK_DELETE_PNG, ROM_T18_LANG_CHN_VIDEO_BUTTON_LOCK_DELETE_PNG_SIZE},
		{ROM_T18_LANG_CHN_VIDEO_BUTTON_UNLOCK_DELETE_PNG, ROM_T18_LANG_CHN_VIDEO_BUTTON_UNLOCK_DELETE_PNG_SIZE},

		{ROM_T18_LANG_CHN_VIDEO_BUTTON_RECYCLE_PNG, ROM_T18_LANG_CHN_VIDEO_BUTTON_RECYCLE_PNG_SIZE},
		{ROM_T18_LANG_CHN_VIDEO_BUTTON_PAUSE_PNG, ROM_T18_LANG_CHN_VIDEO_BUTTON_PAUSE_PNG_SIZE},
		{ROM_T18_LANG_CHN_VIDEO_BUTTON_PLAY_PNG, ROM_T18_LANG_CHN_VIDEO_BUTTON_PLAY_PNG_SIZE},

		// "录像回放视窗"
		{ROM_T18_LANG_CHN_VIDEO_VIEW_DIALOG_BUTTON_CANCEL_PNG, ROM_T18_LANG_CHN_VIDEO_VIEW_DIALOG_BUTTON_CANCEL_PNG_SIZE},
		{ROM_T18_LANG_CHN_VIDEO_VIEW_DIALOG_BUTTON_DELETE_PNG, ROM_T18_LANG_CHN_VIDEO_VIEW_DIALOG_BUTTON_DELETE_PNG_SIZE},
		{ROM_T18_LANG_CHN_VIDEO_VIEW_DIALOG_BUTTON_LOCK_PNG, ROM_T18_LANG_CHN_VIDEO_VIEW_DIALOG_BUTTON_LOCK_PNG_SIZE},
		{ROM_T18_LANG_CHN_VIDEO_VIEW_DIALOG_BUTTON_UNLOCK_PNG, ROM_T18_LANG_CHN_VIDEO_VIEW_DIALOG_BUTTON_UNLOCK_PNG_SIZE},
		{ROM_T18_LANG_CHN_VIDEO_VIEW_DIALOG_INFO_SELECT_PNG, ROM_T18_LANG_CHN_VIDEO_VIEW_DIALOG_INFO_SELECT_PNG_SIZE},
		{ROM_T18_LANG_CHN_VIDEO_VIEW_BUTTON_LOCK_PNG, ROM_T18_LANG_CHN_VIDEO_VIEW_BUTTON_LOCK_PNG_SIZE},
		{ROM_T18_LANG_CHN_VIDEO_VIEW_BUTTON_UNLOCK_PNG, ROM_T18_LANG_CHN_VIDEO_VIEW_BUTTON_UNLOCK_PNG_SIZE},
		{ROM_T18_LANG_CHN_VIDEO_VIEW_INFO_VIDEO_DAMAGE_PNG, ROM_T18_LANG_CHN_VIDEO_VIEW_INFO_VIDEO_DAMAGE_PNG_SIZE},
		
		{ROM_T18_LANG_CHN_VIDEO_VIEW_SCAN_VIDEO_FILE_PNG, ROM_T18_LANG_CHN_VIDEO_VIEW_SCAN_VIDEO_FILE_PNG_SIZE},

		// "回收站"
		{ROM_T18_LANG_CHN_RECYCLE_BUTTON_RESTORE_ONE_PNG, ROM_T18_LANG_CHN_RECYCLE_BUTTON_RESTORE_ONE_PNG_SIZE},
		{ROM_T18_LANG_CHN_RECYCLE_BUTTON_RESTORE_ALL_PNG, ROM_T18_LANG_CHN_RECYCLE_BUTTON_RESTORE_ALL_PNG_SIZE},
		{ROM_T18_LANG_CHN_RECYCLE_TITLE_RECYCLE_PNG, ROM_T18_LANG_CHN_RECYCLE_TITLE_RECYCLE_PNG_SIZE},
		{ROM_T18_LANG_CHN_RECYCLE_ICON_VIDEO_24_PNG, ROM_T18_LANG_CHN_RECYCLE_ICON_VIDEO_24_PNG_SIZE},
		{ROM_T18_LANG_CHN_RECYCLE_ICON_PHOTO_24_PNG, ROM_T18_LANG_CHN_RECYCLE_ICON_PHOTO_24_PNG_SIZE},
		{ROM_T18_LANG_CHN_RECYCLE_INFO_RESTORE_FILE_ERROR_PNG, ROM_T18_LANG_CHN_RECYCLE_INFO_RESTORE_FILE_ERROR_PNG_SIZE},
		{ROM_T18_LANG_CHN_RECYCLE_ICON_CHANNEL_1_16_PNG, ROM_T18_LANG_CHN_RECYCLE_ICON_CHANNEL_1_16_PNG_SIZE},
		{ROM_T18_LANG_CHN_RECYCLE_ICON_CHANNEL_2_16_PNG, ROM_T18_LANG_CHN_RECYCLE_ICON_CHANNEL_2_16_PNG_SIZE},

		// "照片"
		{ROM_T18_LANG_CHN_PHOTO_INFO_PHOTO_DAMAGE_PNG, ROM_T18_LANG_CHN_PHOTO_INFO_PHOTO_DAMAGE_PNG_SIZE},

		//“信息视窗”
		{ROM_T18_LANG_CHN_MESSAGE_PROMPT_MESSAGE_TITLE_GIF, ROM_T18_LANG_CHN_MESSAGE_PROMPT_MESSAGE_TITLE_GIF_SIZE},
		{ROM_T18_LANG_CHN_MESSAGE_SUCCESS_GIF, ROM_T18_LANG_CHN_MESSAGE_SUCCESS_GIF_SIZE},
		{ROM_T18_LANG_CHN_MESSAGE_FAIL_GIF, ROM_T18_LANG_CHN_MESSAGE_FAIL_GIF_SIZE},

		//“行车记录视窗”
		{ROM_T18_LANG_CHN_DESKTOP_ALERT_FORMAT_PNG, ROM_T18_LANG_CHN_DESKTOP_ALERT_FORMAT_PNG_SIZE},
		{ROM_T18_LANG_CHN_DESKTOP_ALERT_FORMAT_PRESSED_PNG, ROM_T18_LANG_CHN_DESKTOP_ALERT_FORMAT_PRESSED_PNG_SIZE},
		{ROM_T18_LANG_CHN_DESKTOP_ALERT_CANCEL_PNG, ROM_T18_LANG_CHN_DESKTOP_ALERT_CANCEL_PNG_SIZE},
		{ROM_T18_LANG_CHN_DESKTOP_ALERT_CANCEL_PRESSED_PNG, ROM_T18_LANG_CHN_DESKTOP_ALERT_CANCEL_PRESSED_PNG_SIZE},

		// 系统升级对话框
		{ROM_T18_LANG_CHN_SYSTEMUPDATE_MESSAGE_TITLE_PNG, ROM_T18_LANG_CHN_SYSTEMUPDATE_MESSAGE_TITLE_PNG_SIZE},
		{ROM_T18_LANG_CHN_SYSTEMUPDATE_MESSAGE_BUTTON_YES_PNG, ROM_T18_LANG_CHN_SYSTEMUPDATE_MESSAGE_BUTTON_YES_PNG_SIZE},
		{ROM_T18_LANG_CHN_SYSTEMUPDATE_MESSAGE_BUTTON_CANCEL_PNG, ROM_T18_LANG_CHN_SYSTEMUPDATE_MESSAGE_BUTTON_CANCEL_PNG_SIZE},
		{ROM_T18_COMMON_RIGHT_ARROW_PNG, ROM_T18_COMMON_RIGHT_ARROW_PNG_SIZE},
		// 语言
		{ROM_T18_LANG_CHN_SETTING_LANG_CHINESE_SIMPLIFIED_PNG,ROM_T18_LANG_CHN_SETTING_LANG_CHINESE_SIMPLIFIED_PNG_SIZE},
		{ROM_T18_LANG_CHN_SETTING_LANG_ENGLISH_PNG, ROM_T18_LANG_CHN_SETTING_LANG_ENGLISH_PNG_SIZE},
		{ROM_T18_LANG_CHN_SETTING_LANG_RUSSIAN_PNG, ROM_T18_LANG_CHN_SETTING_LANG_RUSSIAN_PNG_SIZE},
		{ROM_T18_LANG_CHN_SETTING_LANG_CHINESE_TRADITIONAL_PNG, ROM_T18_LANG_CHN_SETTING_LANG_CHINESE_TRADITIONAL_PNG_SIZE},
		{ROM_T18_LANG_CHN_SETTING_LANG_FRENCH_PNG, ROM_T18_LANG_CHN_SETTING_LANG_FRENCH_PNG_SIZE},
		{ROM_T18_LANG_CHN_SETTING_LANG_JAPANESE_PNG, ROM_T18_LANG_CHN_SETTING_LANG_JAPANESE_PNG_SIZE},
		{ROM_T18_LANG_CHN_SETTING_LANG_KOREAN_PNG, ROM_T18_LANG_CHN_SETTING_LANG_KOREAN_PNG_SIZE},
		{ROM_T18_LANG_CHN_SETTING_LANG_GERMAN_PNG, ROM_T18_LANG_CHN_SETTING_LANG_GERMAN_PNG_SIZE},
		// ALERT
		{ROM_T18_COMMON_ALERT_BUTTON_NORMAL_PNG, ROM_T18_COMMON_ALERT_BUTTON_NORMAL_PNG_SIZE},
		{ROM_T18_COMMON_ALERT_BUTTON_PRESSED_PNG, ROM_T18_COMMON_ALERT_BUTTON_PRESSED_PNG_SIZE},
		{ROM_T18_COMMON_ALERT_BUTTON_OK_NORMAL_PNG, ROM_T18_COMMON_ALERT_BUTTON_OK_NORMAL_PNG_SIZE},
		{ROM_T18_COMMON_ALERT_BUTTON_OK_PRESSED_PNG, ROM_T18_COMMON_ALERT_BUTTON_OK_PRESSED_PNG_SIZE},
		{ROM_T18_LANG_CHN_SETTING_ALERT_MESSAGE_PNG,ROM_T18_LANG_CHN_SETTING_ALERT_MESSAGE_PNG_SIZE},

		// ERGENT紧急录像
		{ROM_T18_LANG_CHN_DESKTOP_ERGENT_RECORD_MESSAGE_PNG, ROM_T18_LANG_CHN_DESKTOP_ERGENT_RECORD_MESSAGE_PNG_SIZE},
		{ROM_T18_LANG_CHN_DESKTOP_URGENT_RECORD_IMAGE_PNG, ROM_T18_LANG_CHN_DESKTOP_URGENT_RECORD_IMAGE_PNG_SIZE},

		// 铃声、录音音量
		{ROM_T18_LANG_CHN_SOUNDVOLUME_BELL_VOLUME_TITLE_PNG, ROM_T18_LANG_CHN_SOUNDVOLUME_BELL_VOLUME_TITLE_PNG_SIZE},
		{ROM_T18_LANG_CHN_SOUNDVOLUME_MIC_VOLUME_TITLE_PNG, ROM_T18_LANG_CHN_SOUNDVOLUME_MIC_VOLUME_TITLE_PNG_SIZE},
		{ROM_T18_LANG_CHN_SOUNDVOLUME_BELL_VOLUME_PNG, ROM_T18_LANG_CHN_SOUNDVOLUME_BELL_VOLUME_PNG_SIZE},
		{ROM_T18_LANG_CHN_SOUNDVOLUME_MIC_VOLUME_PNG, ROM_T18_LANG_CHN_SOUNDVOLUME_MIC_VOLUME_PNG_SIZE},
		{ROM_T18_LANG_CHN_SOUNDVOLUME_BELL_VOLUME_80X80_PNG, ROM_T18_LANG_CHN_SOUNDVOLUME_BELL_VOLUME_80X80_PNG_SIZE},
		{ROM_T18_LANG_CHN_SOUNDVOLUME_MIC_80X80_PNG, ROM_T18_LANG_CHN_SOUNDVOLUME_MIC_80X80_PNG_SIZE},
		{ROM_T18_LANG_CHN_SOUNDVOLUME_VOLUME_ADJUST_PNG, ROM_T18_LANG_CHN_SOUNDVOLUME_VOLUME_ADJUST_PNG_SIZE},

		// USB连接、断开
		{ROM_T18_LANG_CHN_USB_USB_CHARGE_TITLE_PNG, ROM_T18_LANG_CHN_USB_USB_CHARGE_TITLE_PNG_SIZE},
		{ROM_T18_LANG_CHN_USB_USB_CHARGE_PNG, ROM_T18_LANG_CHN_USB_USB_CHARGE_PNG_SIZE},
		{ROM_T18_LANG_CHN_USB_USB_UDISK_TITLE_PNG, ROM_T18_LANG_CHN_USB_USB_UDISK_TITLE_PNG_SIZE},
		{ROM_T18_LANG_CHN_USB_USB_UDISK_PNG, ROM_T18_LANG_CHN_USB_USB_UDISK_PNG_SIZE},
		{ROM_T18_LANG_CHN_USB_USB_DISCONNECT_TITLE_PNG, ROM_T18_LANG_CHN_USB_USB_DISCONNECT_TITLE_PNG_SIZE},
		{ROM_T18_LANG_CHN_USB_USB_DISCONNECT_PNG, ROM_T18_LANG_CHN_USB_USB_DISCONNECT_PNG_SIZE},

		// GPSBD定位
		{ROM_T18_LANG_CHN_GPS_GPS_ICON_PNG, ROM_T18_LANG_CHN_GPS_GPS_ICON_PNG_SIZE},
		{ROM_T18_LANG_CHN_GPS_GPSBD_DISCONNECT_PNG, ROM_T18_LANG_CHN_GPS_GPSBD_DISCONNECT_PNG_SIZE},
		{ROM_T18_LANG_CHN_GPS_GPSBD_CONNECT_LOCATE_OK_PNG, ROM_T18_LANG_CHN_GPS_GPSBD_CONNECT_LOCATE_OK_PNG_SIZE},

		// 测速雷达报警
		{ROM_T18_LANG_CHN_RADARALARM_RADAR_ALARM_TITLE_PNG, ROM_T18_LANG_CHN_RADARALARM_RADAR_ALARM_TITLE_PNG_SIZE},

		// 疲劳驾驶
		{ROM_T18_LANG_CHN_DRIVING_LONGTIMEDRIVINGWARNING_PNG, ROM_T18_LANG_CHN_DRIVING_LONGTIMEDRIVINGWARNING_PNG_SIZE},
		{ROM_T18_LANG_CHN_DRIVING_LONGTIMEDRIVINGALARM_PNG, ROM_T18_LANG_CHN_DRIVING_LONGTIMEDRIVINGALARM_PNG_SIZE},
		{ROM_T18_LANG_CHN_DRIVING_LONGTIMEDRIVINGFLAG_PNG, ROM_T18_LANG_CHN_DRIVING_LONGTIMEDRIVINGFLAG_PNG_SIZE},

		// 循环录像报警
		{ROM_T18_LANG_CHN_RECYCLERECORD_RECYCLE_RECORD_LOW_PNG, ROM_T18_LANG_CHN_RECYCLERECORD_RECYCLE_RECORD_LOW_PNG_SIZE},
		{ROM_T18_LANG_CHN_RECYCLERECORD_SDCARD_SPACE_PNG, ROM_T18_LANG_CHN_RECYCLERECORD_SDCARD_SPACE_PNG_SIZE},
		{ROM_T18_LANG_CHN_RECYCLERECORD_RECYCLE_SPACE_PNG, ROM_T18_LANG_CHN_RECYCLERECORD_RECYCLE_SPACE_PNG_SIZE},
		{ROM_T18_LANG_CHN_RECYCLERECORD_LOCKED_SPACE_PNG, ROM_T18_LANG_CHN_RECYCLERECORD_LOCKED_SPACE_PNG_SIZE},
		{ROM_T18_LANG_CHN_RECYCLERECORD_OTHERS_SPACE_PNG, ROM_T18_LANG_CHN_RECYCLERECORD_OTHERS_SPACE_PNG_SIZE},

		//ADD BY EASON
		/*
		{ROM_T18_LANG_CHN_MAIN_REPLAY_DOWN_PNG,ROM_T18_LANG_CHN_MAIN_REPLAY_DOWN_PNG_SIZE},
		{ROM_T18_LANG_CHN_MAIN_REPLAY_UP_PNG,ROM_T18_LANG_CHN_MAIN_REPLAY_UP_PNG_SIZE},
        {ROM_T18_LANG_CHN_MAIN_SET_DOWN_PNG,ROM_T18_LANG_CHN_MAIN_SET_DOWN_PNG_SIZE},
		{ROM_T18_LANG_CHN_MAIN_SET_UP_PNG,ROM_T18_LANG_CHN_MAIN_SET_UP_PNG_SIZE},
        {ROM_T18_LANG_CHN_MAIN_VIDEO_DOWN_PNG,ROM_T18_LANG_CHN_MAIN_VIDEO_DOWN_PNG_SIZE},
		{ROM_T18_LANG_CHN_MAIN_VIDEO_UP_PNG,ROM_T18_LANG_CHN_MAIN_VIDEO_UP_PNG_SIZE},
		{ROM_T18_LANG_CHN_MAIN_PHOTO_DOWN_PNG,ROM_T18_LANG_CHN_MAIN_PHOTO_DOWN_PNG_SIZE},
		{ROM_T18_LANG_CHN_MAIN_PHOTO_UP_PNG,ROM_T18_LANG_CHN_MAIN_PHOTO_UP_PNG_SIZE},
		*/
		{ROM_T18_COMMON_UP_26_PNG,ROM_T18_COMMON_UP_26_PNG_SIZE},
	    {ROM_T18_COMMON_DOWN_26_PNG,ROM_T18_COMMON_DOWN_26_PNG_SIZE},
	    {ROM_T18_COMMON_DESKTOP_PHOTO_PNG,ROM_T18_COMMON_DESKTOP_PHOTO_PNG_SIZE},
        {ROM_T18_COMMON_ICON_32X32_MIC_ON_PNG,ROM_T18_COMMON_ICON_32X32_MIC_ON_PNG_SIZE},
        {ROM_T18_COMMON_ICON_32X32_MIC_OFF_PNG,ROM_T18_COMMON_ICON_32X32_MIC_OFF_PNG_SIZE},
		{ROM_T18_LANG_CHN_VIDEOSETTING_MONITOR_PNG,ROM_T18_LANG_CHN_VIDEOSETTING_MONITOR_PNG_SIZE},

		// 停止录像弹窗标题	
		{ROM_T18_LANG_CHN_CARD_STOPVIDEO_PNG, ROM_T18_LANG_CHN_CARD_STOPVIDEO_PNG_SIZE},// STOP ICON
		{ROM_T18_LANG_CHN_CARD_MESSAGE_TITLE_VIDEO_STOP_PNG, ROM_T18_LANG_CHN_CARD_MESSAGE_TITLE_VIDEO_STOP_PNG_SIZE},
		{ROM_T18_FONT_S18_DATETIME_CHAR_37_PNG, ROM_T18_FONT_S18_DATETIME_CHAR_37_PNG_SIZE},
            
        {ROM_T18_LANG_CHN_VIDEO_BUTTON_CH_PNG, ROM_T18_LANG_CHN_VIDEO_BUTTON_CH_PNG_SIZE},//通道
        {ROM_T18_COMMON_CH1_PNG, ROM_T18_COMMON_CH1_PNG_SIZE},//CH1
        {ROM_T18_COMMON_CH2_PNG, ROM_T18_COMMON_CH2_PNG_SIZE},//CH2
        {ROM_T18_LANG_CHN_VIDEO_BUTTON_TYPE_PNG, ROM_T18_LANG_CHN_VIDEO_BUTTON_TYPE_PNG_SIZE},//类型
        {ROM_T18_LANG_CHN_VIDEO_BUTTON_PAGE_PNG, ROM_T18_LANG_CHN_VIDEO_BUTTON_PAGE_PNG_SIZE},//页数
        {ROM_T18_LANG_CHN_VIDEO_REPLAYMENU_PNG, ROM_T18_LANG_CHN_VIDEO_REPLAYMENU_PNG_SIZE},//回放菜单
        {ROM_T18_COMMON_BUTTON_RIGHT_PNG, ROM_T18_COMMON_BUTTON_RIGHT_PNG_SIZE},//播放图标
        {ROM_T18_LANG_CHN_VIDEO_INFO_TO_DELETE_ONE_VIDEO_PNG, ROM_T18_LANG_CHN_VIDEO_INFO_TO_DELETE_ONE_VIDEO_PNG_SIZE},//确认是否删除当前文件
        {ROM_T18_LANG_CHN_VIDEO_INFO_TO_DELETE_ALL_VIDEO_PNG, ROM_T18_LANG_CHN_VIDEO_INFO_TO_DELETE_ALL_VIDEO_PNG_SIZE},//确认是否删除所有文件
		{ROM_T18_COMMON_MENU_SYS_MENU_SYS_ALERT_BG_PNG, ROM_T18_COMMON_MENU_SYS_MENU_SYS_ALERT_BG_PNG_SIZE},//弹窗背景图片
		{ROM_T18_COMMON_MENU_SYS_MENU_TITLE_FORMAT_PNG, ROM_T18_COMMON_MENU_SYS_MENU_TITLE_FORMAT_PNG_SIZE},//弹窗背景图片
		{ROM_T18_COMMON_MENU_SYS_MENU_IF_SD_FORMAT_PNG, ROM_T18_COMMON_MENU_SYS_MENU_IF_SD_FORMAT_PNG_SIZE},//是否进行SD卡格式化
		{ROM_T18_COMMON_MENU_SYS_MENU_SD_FORMAT_ING_PNG, ROM_T18_COMMON_MENU_SYS_MENU_SD_FORMAT_ING_PNG_SIZE},//正在格式化
		{ROM_T18_COMMON_MENU_SYS_MENU_SD_FORMAT_OK_PNG, ROM_T18_COMMON_MENU_SYS_MENU_SD_FORMAT_OK_PNG_SIZE},//格式化成功
		{ROM_T18_COMMON_MENU_SYS_MENU_SD_FORMAT_PNG, ROM_T18_COMMON_MENU_SYS_MENU_SD_FORMAT_PNG_SIZE},//格式化失败
		{ROM_T18_COMMON_MENU_SYS_MENU_TXT_OK_PNG, ROM_T18_COMMON_MENU_SYS_MENU_TXT_OK_PNG_SIZE},//确定
		{ROM_T18_COMMON_MENU_SYS_MENU_TXT_CANCEL_PNG, ROM_T18_COMMON_MENU_SYS_MENU_TXT_CANCEL_PNG_SIZE},//取消
		{ROM_T18_COMMON_MENU_SYS_MENU_ALERT_BTN_A_PNG, ROM_T18_COMMON_MENU_SYS_MENU_ALERT_BTN_A_PNG_SIZE},//按钮选中

		{ROM_T18_COMMON_MENU_SYS_MENU_TITLE_RESET_PNG, ROM_T18_COMMON_MENU_SYS_MENU_TITLE_RESET_PNG_SIZE},//恢复默认标题
		{ROM_T18_COMMON_MENU_SYS_MENU_RESET_OPTION_PNG, ROM_T18_COMMON_MENU_SYS_MENU_RESET_OPTION_PNG_SIZE},//是否恢复成默认值
		{ROM_T18_COMMON_MENU_SYS_MENU_TITLE_RESET_PNG, ROM_T18_COMMON_MENU_SYS_MENU_TITLE_RESET_PNG_SIZE},//所有参数被恢复成默认值

		{ROM_T18_COMMON_BUTTON_LEFT_PNG, ROM_T18_COMMON_BUTTON_LEFT_PNG_SIZE},//左向图标
		{ROM_T18_COMMON_BUTTON_RIGHT_PNG, ROM_T18_COMMON_BUTTON_RIGHT_PNG_SIZE},//右向图标
	},
	// 繁体中文资源 
};

#include <xm_printf.h>
// 根据菜单ID获取对应的ROM资源ID
APPROMRES*	AP_AppRes2RomRes (u32_t MenuID)
{
#if 0
	int lang = AppMenuData.lang;
	if(MenuID == AP_NULLID)
	{
		XM_printf ("NULL menu id \n");
		return NULL;
	}
	// 缺省使用英文资源
	if(lang >= AP_LANG_COUNT)
		lang =  AP_SETTING_LANG_ENGLISH;
	if(MenuID >= AP_ID_COUNT)
	{
		//XM_ASSERT (0);
		XM_printf ("menu id (%d) invalid\n", MenuID);
		return NULL;
	}
	return (APPROMRES*)&MenuID2RomID[lang][MenuID];
#endif
    //thera's only chinese simple;
	return (APPROMRES*)&MenuID2RomID[AP_SETTING_LANG_CHINESE_SIMPLIFIED][MenuID];
}

// 根据菜单ID获取对应的ROM资源偏移
u32_t	AP_AppRes2RomOffset (u32_t MenuID)
{
#if 0
	int lang = AppMenuData.lang;
	if(MenuID == AP_NULLID)
	{
		XM_printf ("NULL menu id \n");
		return 0;
	}
	// 缺省使用英文资源
	if(lang >= AP_LANG_COUNT)
		lang =  AP_SETTING_LANG_ENGLISH;
	if(MenuID >= AP_ID_COUNT)
	{
		//XM_ASSERT (0);
		XM_printf ("menu id (%d) invalid\n", MenuID);
		return 0;
	}
	return MenuID2RomID[lang][MenuID].rom_offset;
#endif
    //thera's only chinese simple;
	return MenuID2RomID[AP_SETTING_LANG_CHINESE_SIMPLIFIED][MenuID].rom_offset;
}

#include <xm_key.h>
// 获取与按键关联的提示资源
// Key	按键的键值
APPROMRES* AP_AppGetKeyClueRes (u32_t Key)
{
	int lang = AppMenuData.lang;
	// 缺省使用英文资源
	//if(lang >= AP_LANG_COUNT)
	//	lang =  AP_SETTING_LANG_ENGLISH;
		
	if(lang >= AP_LANG_COUNT)
		lang =  AP_SETTING_LANG_CHINESE_SIMPLIFIED;
		
	if(Key == VK_AP_MENU)
		return (APPROMRES*)&MenuID2RomID[lang][AP_ID_COMMON_MENU];
	else if(Key == VK_AP_MODE)
		return (APPROMRES*)&MenuID2RomID[lang][AP_ID_COMMON_OK];
	else if(Key == VK_AP_SWITCH)
		return (APPROMRES*)&MenuID2RomID[lang][AP_ID_COMMON_MODE];
	else
	{
		XM_printf ("AP_AppGetKeyClueRes failed, key id (%d) invalid\n", Key);
		return NULL;

	}
}

