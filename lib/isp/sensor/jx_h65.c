#include "arkn141_isp_sensor_cfg.h"
#include <stdio.h>
#include <string.h>

#include "xm_proj_define.h"
#include "xm_i2c.h"
#include "arkn141_isp_cmos_sensor_io.h"

#if ARKN141_CMOS_SENSOR == ARKN141_CMOS_SENSOR_JX_H65

// JX-H65 slave ID is programmable, default is 0x60/61 for write and read command
#define	SEN_I2C_ADDR				(0x60 >> 1)
//#define	SEN_I2C_ADDR				(0x6c >> 1)
//#define	SEN_I2C_ADDR				(0x64 >> 1)
//#define	SEN_I2C_ADDR				(0x64 >> 1)


static int I2C_WRITE(unsigned int addr, unsigned int data)
{
	return i2c_reg8_write8(SEN_I2C_ADDR,(addr),(data));	
}

#define	I2C_WRITE_BYTE(addr,data,size)	\
	if(I2C_WRITE((addr), (data)) < 0)	\
		return -1;


typedef struct tagCONFIG_DATA {
	unsigned int	addr;
	unsigned int	data;
} CONFIG_DATA;

//#define		W_1600_H_750	1		// 初始参数
//#define	W_1500_H_800	1
//#define	W_1450_H_825	1
//#define	W_1410_H_850	1
#define	W_1600_H_900	1		// 25fps

static CONFIG_DATA  jx_h65_reg[] = {
	{0x12,    0x40},    	
	{0x0E,    0x10},     
	{0x0F,    0x04},     
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	{0x48,    0x25},  
#if W_1600_H_750	//
	{0x20,    0x20},   
	{0x21,    0x03},   
	{0x22,    0xEE},   
	{0x23,    0x02}, 
#elif W_1500_H_800
	{0x20,    0xEE},   
	{0x21,    0x02},   
	{0x22,    0x20},   
	{0x23,    0x03}, 
#elif W_1450_H_825
	{0x20,    0xD5},   
	{0x21,    0x02},   
	{0x22,    0x39},   
	{0x23,    0x03}, 
#elif W_1410_H_850
	{0x20,    0xC1},   
	{0x21,    0x02},   
	{0x22,    0x52},   
	{0x23,    0x03}, 
#elif W_1600_H_900
	{0x20,    0x20},   
	{0x21,    0x03},   
	{0x22,    0x84},   
	{0x23,    0x03}, 	
#endif
	{0x24,    0x80},
	//{0x24,    0x84},
	{0x25,    0xD0},
	{0x26,    0x22},
	{0x27,    0x5C - 8},		// 修改窗口起始位置(左移8个像素点)
	{0x28,    0x18},
	{0x29,    0x01},
	{0x2A,    0x48},
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	{0x1D,    0xFF},
	//{0x1E,    0x1F},
	//{0x1E,    0x1F | (1 << 5) | (1 << 7)},	// 
	{0x1E,    0x1F | (1 << 7) | (1 << 5)},
	{0x6C,    0x80},
	{0x1F,    0x10},
	{0x31,    0x0C},
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	{0x93,    0x68}
} ;

int jx_h65_init (void)
{
	int i;
	int ret;
	
	// read id
	unsigned int PIDH, PIDL;
	PIDH = 0;
	PIDL = 0;
	ret = -1;
	i2c_reg8_read8 (SEN_I2C_ADDR, 0x0A, &PIDH);
	i2c_reg8_read8 (SEN_I2C_ADDR, 0x0B, &PIDL);
	XM_printf ("PIDH=%02x, PIDL=%02x\n", PIDH, PIDL);
	if(PIDH == 0x0A && PIDL == 0x65 || PIDH == 0x00 && PIDL == 0x65)
	{
		ret = 0;
		XM_printf ("Found jx_h65\n");
	}
	else
	{
		XM_printf ("Miss  jx_h65\n");
	//	return -1;
	}
	
	
	
	for (i = 0; i < sizeof(jx_h65_reg)/sizeof(jx_h65_reg[0]); i ++)
	{
		if(I2C_WRITE(jx_h65_reg[i].addr, jx_h65_reg[i].data) < 0)
			return -1;
	}

	OS_Delay (1);

	if(I2C_WRITE (0x45, 0x19) < 0)
		return -1;
	
	if(I2C_WRITE (0x1F, 0x11) < 0)
		return -1;
	
#if 1  //解决从视频回放列表返回到录像时闪的问题
	I2C_WRITE (0x00, 0x00);
	I2C_WRITE (0x01, 0x00);
	I2C_WRITE (0x02, 0x00);
#endif

	return 0;
}

#endif	// #if ARKN141_CMOS_SENSOR == ARKN141_CMOS_SENSOR_GC0308
