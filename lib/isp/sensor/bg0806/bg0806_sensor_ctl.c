#include <stdio.h>
#include <sys/types.h>
#include <sys/stat.h>
#include <sys/ioctl.h>
#include <fcntl.h>
#include <unistd.h>

#include "hi_comm_video.h"
#include "bg0806.h"

#ifdef HI_GPIO_I2C
#include "gpioi2c_ex.h"
#else
#include "hi_i2c.h"
#endif


#define DSC_ADDR_BASE 0x0400

//如果系统VDDIO使用3.3V请定义此宏定义值为1
//如果系统VDDIO使用1.8V请定义此宏定义值为0
#define	VDDIO_VOLTAGE_3V3		1	


const unsigned int 	sensor_i2c_addr	=	0x64;		/* I2C Address of bg0803 */
const unsigned int  sensor_addr_byte	=	2;
const unsigned int  sensor_data_byte	=	1;
static int g_fd = -1;
static int flag_init = 0;

extern WDR_MODE_E genSensorMode;
extern HI_U8 gu8SensorImageMode;
extern HI_BOOL bSensorInit;


const HI_U8 Tab_sensor_dsc[768] = {
	//20170206 update dsc	external ldo
	0x0a, 0x5c, 0x09, 0x4a, 0x08, 0x07, 0x06, 0xee, 0x06, 0x23, 0x05, 0x7e, 0x05, 0x21, 0x05, 0x01, 0x05, 0xcc, 0x06, 0xf5, 
	0x08, 0x0b, 0x09, 0x0e, 0x0a, 0x0e, 0x0b, 0x34, 0x0c, 0x42, 0x0e, 0x9b, 0x09, 0xe0, 0x08, 0x71, 0x06, 0xce, 0x05, 0xd7, 
	0x05, 0x19, 0x04, 0x9c, 0x04, 0x54, 0x04, 0x4d, 0x04, 0xd2, 0x05, 0xf8, 0x07, 0x04, 0x07, 0xe3, 0x08, 0xe2, 0x09, 0xfe, 
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	0x05, 0xc7, 0x06, 0x72, 0x07, 0x84, 0x0a, 0x0d

};

int sensor_i2c_init(void)
{
    if(g_fd >= 0)
    {
        return 0;
    }    
#ifdef HI_GPIO_I2C
    int ret;

    g_fd = open("/dev/gpioi2c_ex", 0);
    if(g_fd < 0)
    {
        printf("Open gpioi2c_ex error!\n");
        return -1;
    }
#else
    int ret;

    g_fd = open("/dev/i2c-0", O_RDWR);
    if(g_fd < 0)
    {
        printf("Open /dev/i2c-0 error!\n");
        return -1;
    }

    ret = ioctl(g_fd, I2C_SLAVE_FORCE, sensor_i2c_addr);
    if (ret < 0)
    {
        printf("CMD_SET_DEV error!\n");
        return ret;
    }
#endif

    return 0;
}

int sensor_i2c_exit(void)
{
    if (g_fd >= 0)
    {
        close(g_fd);
        g_fd = -1;
        return 0;
    }
    return -1;
}
int sensor_read_register(int addr)
{
	int ret;
	int data;
	char recvbuf[4];
	
    if(flag_init == 0)
    {
		sensor_i2c_init();
		flag_init = 1;
    }
	
	if (sensor_addr_byte == 2)
		ret = ioctl(g_fd, I2C_16BIT_REG, 1);
	else
		ret = ioctl(g_fd, I2C_16BIT_REG, 0);
	if (ret < 0) {
		printf("CMD_SET_REG_WIDTH error!\n");
		return -1;
	}
	if (sensor_data_byte == 2)
		ret = ioctl(g_fd, I2C_16BIT_DATA, 1);
	else
		ret = ioctl(g_fd, I2C_16BIT_DATA, 0);
	if (ret < 0) {
		printf("CMD_SET_DATA_WIDTH error!\n");
		return -1;
	}

	if (sensor_addr_byte == 2) {
		recvbuf[0] = addr & 0xff;
		recvbuf[1] = (addr >> 8) & 0xff;
	} else
		recvbuf[0] = addr & 0xff;
		ret = read(g_fd, recvbuf, sensor_addr_byte);
	if (ret < 0) {
		printf("CMD_I2C_READ error!\n");
		return -1;
	}
	if (sensor_data_byte == 2) {
		data = recvbuf[0] | (recvbuf[1] << 8);
	} else{
		data = recvbuf[0];
//		printf("0x%x 0x%x\n", sensor_i2c_addr, data);
	}
	return data;
	
}

int sensor_write_register(int addr, int data)
{
#ifdef HI_GPIO_I2C
    i2c_data.dev_addr = sensor_i2c_addr;
    i2c_data.reg_addr = addr;
    i2c_data.addr_byte_num = sensor_addr_byte;
    i2c_data.data = data;
    i2c_data.data_byte_num = sensor_data_byte;

    ret = ioctl(g_fd, GPIO_I2C_WRITE, &i2c_data);

    if (ret)
    {
        printf("GPIO-I2C write faild!\n");
        return ret;
    }
#else
    if(flag_init == 0)
    {
		sensor_i2c_init();
		flag_init = 1;
    }

    int idx = 0;
    int ret;
    char buf[8];

    buf[idx++] = addr & 0xFF;
    if (sensor_addr_byte == 2)
    {
    	ret = ioctl(g_fd, I2C_16BIT_REG, 1);
        buf[idx++] = addr >> 8;
    }
    else
    {
    	ret = ioctl(g_fd, I2C_16BIT_REG, 0);
    }

    if (ret < 0)
    {
        printf("CMD_SET_REG_WIDTH error!\n");
        return -1;
    }

    buf[idx++] = data;
    if (sensor_data_byte == 2)
    {
    	ret = ioctl(g_fd, I2C_16BIT_DATA, 1);
        buf[idx++] = data >> 8;
    }
    else
    {
    	ret = ioctl(g_fd, I2C_16BIT_DATA, 0);
    }

    if (ret)
    {
        printf("hi_i2c write faild!\n");
        return -1;
    }

    ret = write(g_fd, buf, idx);
    if(ret < 0)
    {
    	printf("I2C_WRITE error!\n");
    	return -1;
    }
#endif
	return 0;
}


void sensor_linear_1080p30_init();



void sensor_init()
{
    sensor_i2c_init();

    sensor_linear_1080p30_init();

	bSensorInit = HI_TRUE;
	
    return ;
}

void sensor_exit()
{
    sensor_i2c_exit();
	flag_init = 0;
    return;
}
void sensor_linear_1080p30_init()
{
	HI_U8	dsc_value,pid;
	HI_U16	i;

	//MCLK=24Mhz,PCLK=75Mhz,30fps
	sensor_write_register(0x0200, 0x0001);
	sensor_write_register(0x000e, 0x0008);//0806_4times_75M_30fps
	sensor_write_register(0x000f, 0x00ae);//row time F_W=2222
	sensor_write_register(0x0013, 0x0001);
	sensor_write_register(0x0021, 0x0000);
	sensor_write_register(0x0022, 0x0025);//vblank
	sensor_write_register(0x0028, 0x0000);
	sensor_write_register(0x0029, 0x0030);
	sensor_write_register(0x002a, 0x0000);
	sensor_write_register(0x002b, 0x0030);
	sensor_write_register(0x0030, 0x0000);
	sensor_write_register(0x0031, 0x00d0);//rstb2rmp1 gap
	sensor_write_register(0x0034, 0x0000);
	sensor_write_register(0x0035, 0x00d0);//tx2rmp2 gap
	sensor_write_register(0x003c, 0x0001);
	sensor_write_register(0x003d, 0x0084);//rmp1_w@pclk domain
	sensor_write_register(0x003e, 0x0005);//ncp
	sensor_write_register(0x0042, 0x0001);
#if	VDDIO_VOLTAGE_3V3
	sensor_write_register(0x005c, 0x07);//lsh_io ctrlbit for 3.3VDDIO
#else
	sensor_write_register(0x005c, 0x00);//lsh_io ctrlbit for 1.8VDDIO
#endif
	sensor_write_register(0x0061, 0x0004);
	sensor_write_register(0x0062, 0x005c);//rmp2_w@pclk domain
	sensor_write_register(0x0064, 0x0000);
	sensor_write_register(0x0065, 0x0080);//rmp1_w@rmpclk domain
	sensor_write_register(0x0067, 0x0001);
	sensor_write_register(0x0068, 0x0090);//rmp2_w@rmpclk domain
	sensor_write_register(0x006c, 0x0003);//pd mipi dphy&dphy ldo
	sensor_write_register(0x007f, 0x0003);
	sensor_write_register(0x0080, 0x0001); //dot en disable
	sensor_write_register(0x0081, 0x0000);
	sensor_write_register(0x0082, 0x000b);
	sensor_write_register(0x0084, 0x0008);
	sensor_write_register(0x0088, 0x0005);//pclk dly
	sensor_write_register(0x008e, 0x0000);
	sensor_write_register(0x008f, 0x0000);
	sensor_write_register(0x0090, 0x0001);
	sensor_write_register(0x0094, 0x0001);//rmp div1
	sensor_write_register(0x0095, 0x0001);//rmp div4
	sensor_write_register(0x009e, 0x0003);//4 times
	sensor_write_register(0x009f, 0x0020);//rmp2gap@rmpclk
	sensor_write_register(0x00b1, 0x007f);
	sensor_write_register(0x00b2, 0x0002);
	sensor_write_register(0x00bc, 0x0002);
	sensor_write_register(0x00bd, 0x0000);
	sensor_write_register(0x0120, 0x0001);//blc on 01 direct
	sensor_write_register(0x0132, 0x0001);//k
	sensor_write_register(0x0133, 0x0060);
	sensor_write_register(0x0139, 0x0007);
	sensor_write_register(0x0139, 0x00ff);
	sensor_write_register(0x013b, 0x0008);
	sensor_write_register(0x01a5, 0x0007);//row noise on 07
	sensor_write_register(0x0160, 0x0000);
	sensor_write_register(0x0161, 0x0030);
	sensor_write_register(0x0162, 0x0000);
	sensor_write_register(0x0163, 0x0030);
	sensor_write_register(0x0164, 0x0000);
	sensor_write_register(0x0165, 0x0030);
	sensor_write_register(0x0166, 0x0000);
	sensor_write_register(0x0167, 0x0030);
	sensor_write_register(0x0206, 0x0000);
	sensor_write_register(0x0207, 0x0000);
	sensor_write_register(0x0053, 0x0000);
	sensor_write_register(0x0054, 0x0028);//plm_cnt
	sensor_write_register(0x0055, 0x0000);//pln_cnt
	
	sensor_write_register(0x00f3, 0x0000);
	sensor_write_register(0x00f4, 0x007b);//plm
	sensor_write_register(0x00f5, 0x0006);//pln,371.25M pll
	
	sensor_write_register(0x006d, 0x0003);//pclk_ctrl, 03 for 1p25,0c for 1p5
	sensor_write_register(0x006c, 0x0000);//ldo_ctrl,00
	sensor_write_register(0x008d, 0x003f);//
	sensor_write_register(0x008e, 0x0000);//oen_ctrl,0c
	sensor_write_register(0x008f, 0x0000);//io_sel_ctrl,03
	sensor_write_register(0x00fa, 0x008f);//ispc,c7
	sensor_write_register(0x0391, 0x0000);//mipi_ctrl1,(raw10)
	sensor_write_register(0x0392, 0x0000);//mipi_ctrl2,default
	sensor_write_register(0x0393, 0x0001);//mipi_ctrl3,default
	sensor_write_register(0x0398, 0x000a);//28(25M),14(50M),0a(100M),08(111.375)
	sensor_write_register(0x0390, 0x0000);//mipi_ctrl0,bit[1],mipi enable
	
	sensor_write_register(0x006e, 0x0000);

	//dsc_k blcc_k different with chip pid
#define BG0806A		0x01
#define BG0806C1	0x07
#define BG0806C2	0x0b
#define BG0806B1	0x03
#define BG0806B2	0x0f
	pid = sensor_read_register(0x45)&0x3f;
	switch(pid){
		case BG0806A:
			sensor_write_register(0x0206, 0x02);
			sensor_write_register(0x0207, 0xc8);
			sensor_write_register(0x0132, 0x01); //k
			sensor_write_register(0x0133, 0x38);
			break;
		case BG0806C1:
		case BG0806C2:
			sensor_write_register(0x0206, 0x02);
			sensor_write_register(0x0207, 0xaa);
			sensor_write_register(0x0132, 0x01); //k
			sensor_write_register(0x0133, 0x56);
			break;
		case BG0806B1:
		case BG0806B2:
		default:
			sensor_write_register(0x0206, 0x02);
			sensor_write_register(0x0207, 0xde);
			sensor_write_register(0x0132, 0x01); //k
			sensor_write_register(0x0133, 0x22);
			break;
	}
	for (i=0; i<768; i++)
	{
		dsc_value= (unsigned short)(Tab_sensor_dsc[i]);
		sensor_write_register(DSC_ADDR_BASE+i, dsc_value);
	}
	sensor_write_register(0x001d, 0x01);
	printf("---	FH8830 BG0806 ipc 30fps inital ok----\n");
}

